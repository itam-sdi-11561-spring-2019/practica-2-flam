
C:\\Users\\Mike\\AppData\\Local\\Temp\\arduino_build_599998/promedio.ino.elf:     file format elf32-avr


Disassembly of section .text:

00000000 <__vectors>:
       0:	ef c0       	rjmp	.+478    	; 0x1e0 <__ctors_end>
       2:	00 00       	nop
       4:	1c c1       	rjmp	.+568    	; 0x23e <__bad_interrupt>
       6:	00 00       	nop
       8:	1a c1       	rjmp	.+564    	; 0x23e <__bad_interrupt>
       a:	00 00       	nop
       c:	18 c1       	rjmp	.+560    	; 0x23e <__bad_interrupt>
       e:	00 00       	nop
      10:	16 c1       	rjmp	.+556    	; 0x23e <__bad_interrupt>
      12:	00 00       	nop
      14:	14 c1       	rjmp	.+552    	; 0x23e <__bad_interrupt>
      16:	00 00       	nop
      18:	12 c1       	rjmp	.+548    	; 0x23e <__bad_interrupt>
      1a:	00 00       	nop
      1c:	10 c1       	rjmp	.+544    	; 0x23e <__bad_interrupt>
      1e:	00 00       	nop
      20:	0e c1       	rjmp	.+540    	; 0x23e <__bad_interrupt>
      22:	00 00       	nop
      24:	0c c1       	rjmp	.+536    	; 0x23e <__bad_interrupt>
      26:	00 00       	nop
      28:	0a c1       	rjmp	.+532    	; 0x23e <__bad_interrupt>
      2a:	00 00       	nop
      2c:	08 c1       	rjmp	.+528    	; 0x23e <__bad_interrupt>
      2e:	00 00       	nop
      30:	06 c1       	rjmp	.+524    	; 0x23e <__bad_interrupt>
      32:	00 00       	nop
      34:	04 c1       	rjmp	.+520    	; 0x23e <__bad_interrupt>
      36:	00 00       	nop
      38:	02 c1       	rjmp	.+516    	; 0x23e <__bad_interrupt>
      3a:	00 00       	nop
      3c:	00 c1       	rjmp	.+512    	; 0x23e <__bad_interrupt>
      3e:	00 00       	nop
      40:	fe c0       	rjmp	.+508    	; 0x23e <__bad_interrupt>
      42:	00 00       	nop
      44:	fc c0       	rjmp	.+504    	; 0x23e <__bad_interrupt>
      46:	00 00       	nop
      48:	fa c0       	rjmp	.+500    	; 0x23e <__bad_interrupt>
      4a:	00 00       	nop
      4c:	f8 c0       	rjmp	.+496    	; 0x23e <__bad_interrupt>
      4e:	00 00       	nop
      50:	f6 c0       	rjmp	.+492    	; 0x23e <__bad_interrupt>
      52:	00 00       	nop
      54:	f4 c0       	rjmp	.+488    	; 0x23e <__bad_interrupt>
      56:	00 00       	nop
      58:	f2 c0       	rjmp	.+484    	; 0x23e <__bad_interrupt>
      5a:	00 00       	nop
      5c:	0e c3       	rjmp	.+1564   	; 0x67a <__vector_23>
      5e:	00 00       	nop
      60:	ee c0       	rjmp	.+476    	; 0x23e <__bad_interrupt>
      62:	00 00       	nop
      64:	7d c3       	rjmp	.+1786   	; 0x760 <__vector_25>
      66:	00 00       	nop
      68:	52 c3       	rjmp	.+1700   	; 0x70e <__vector_26>
      6a:	00 00       	nop
      6c:	e8 c0       	rjmp	.+464    	; 0x23e <__bad_interrupt>
      6e:	00 00       	nop
      70:	e6 c0       	rjmp	.+460    	; 0x23e <__bad_interrupt>
      72:	00 00       	nop
      74:	e4 c0       	rjmp	.+456    	; 0x23e <__bad_interrupt>
      76:	00 00       	nop
      78:	e2 c0       	rjmp	.+452    	; 0x23e <__bad_interrupt>
      7a:	00 00       	nop
      7c:	e0 c0       	rjmp	.+448    	; 0x23e <__bad_interrupt>
      7e:	00 00       	nop
      80:	de c0       	rjmp	.+444    	; 0x23e <__bad_interrupt>
      82:	00 00       	nop
      84:	dc c0       	rjmp	.+440    	; 0x23e <__bad_interrupt>
      86:	00 00       	nop
      88:	da c0       	rjmp	.+436    	; 0x23e <__bad_interrupt>
      8a:	00 00       	nop
      8c:	d8 c0       	rjmp	.+432    	; 0x23e <__bad_interrupt>
      8e:	00 00       	nop
      90:	d6 c0       	rjmp	.+428    	; 0x23e <__bad_interrupt>
      92:	00 00       	nop
      94:	d4 c0       	rjmp	.+424    	; 0x23e <__bad_interrupt>
      96:	00 00       	nop
      98:	d2 c0       	rjmp	.+420    	; 0x23e <__bad_interrupt>
      9a:	00 00       	nop
      9c:	d0 c0       	rjmp	.+416    	; 0x23e <__bad_interrupt>
      9e:	00 00       	nop
      a0:	ce c0       	rjmp	.+412    	; 0x23e <__bad_interrupt>
      a2:	00 00       	nop
      a4:	cc c0       	rjmp	.+408    	; 0x23e <__bad_interrupt>
      a6:	00 00       	nop
      a8:	ca c0       	rjmp	.+404    	; 0x23e <__bad_interrupt>
      aa:	00 00       	nop
      ac:	c8 c0       	rjmp	.+400    	; 0x23e <__bad_interrupt>
      ae:	00 00       	nop
      b0:	c6 c0       	rjmp	.+396    	; 0x23e <__bad_interrupt>
      b2:	00 00       	nop
      b4:	c4 c0       	rjmp	.+392    	; 0x23e <__bad_interrupt>
      b6:	00 00       	nop
      b8:	c2 c0       	rjmp	.+388    	; 0x23e <__bad_interrupt>
      ba:	00 00       	nop
      bc:	c0 c0       	rjmp	.+384    	; 0x23e <__bad_interrupt>
      be:	00 00       	nop
      c0:	be c0       	rjmp	.+380    	; 0x23e <__bad_interrupt>
      c2:	00 00       	nop
      c4:	bc c0       	rjmp	.+376    	; 0x23e <__bad_interrupt>
      c6:	00 00       	nop
      c8:	ba c0       	rjmp	.+372    	; 0x23e <__bad_interrupt>
      ca:	00 00       	nop
      cc:	b8 c0       	rjmp	.+368    	; 0x23e <__bad_interrupt>
      ce:	00 00       	nop
      d0:	b6 c0       	rjmp	.+364    	; 0x23e <__bad_interrupt>
      d2:	00 00       	nop
      d4:	b4 c0       	rjmp	.+360    	; 0x23e <__bad_interrupt>
      d6:	00 00       	nop
      d8:	b2 c0       	rjmp	.+356    	; 0x23e <__bad_interrupt>
      da:	00 00       	nop
      dc:	b0 c0       	rjmp	.+352    	; 0x23e <__bad_interrupt>
      de:	00 00       	nop
      e0:	ae c0       	rjmp	.+348    	; 0x23e <__bad_interrupt>
	...

000000e4 <__trampolines_end>:
      e4:	00 40       	sbci	r16, 0x00	; 0
      e6:	7a 10       	cpse	r7, r10
      e8:	f3 5a       	subi	r31, 0xA3	; 163
      ea:	00 a0       	ldd	r0, Z+32	; 0x20
      ec:	72 4e       	sbci	r23, 0xE2	; 226
      ee:	18 09       	sbc	r17, r8
      f0:	00 10       	cpse	r0, r0
      f2:	a5 d4       	rcall	.+2378   	; 0xa3e <_GLOBAL__sub_I___vector_25+0x14>
      f4:	e8 00       	.word	0x00e8	; ????
      f6:	00 e8       	ldi	r16, 0x80	; 128
      f8:	76 48       	sbci	r23, 0x86	; 134
      fa:	17 00       	.word	0x0017	; ????
      fc:	00 e4       	ldi	r16, 0x40	; 64
      fe:	0b 54       	subi	r16, 0x4B	; 75
     100:	02 00       	.word	0x0002	; ????
     102:	00 ca       	rjmp	.-3072   	; 0xfffff504 <__eeprom_end+0xff7ef504>
     104:	9a 3b       	cpi	r25, 0xBA	; 186
     106:	00 00       	nop
     108:	00 e1       	ldi	r16, 0x10	; 16
     10a:	f5 05       	cpc	r31, r5
     10c:	00 00       	nop
     10e:	80 96       	adiw	r24, 0x20	; 32
     110:	98 00       	.word	0x0098	; ????
     112:	00 00       	nop
     114:	40 42       	sbci	r20, 0x20	; 32
     116:	0f 00       	.word	0x000f	; ????
     118:	00 00       	nop
     11a:	a0 86       	std	Z+8, r10	; 0x08
     11c:	01 00       	.word	0x0001	; ????
     11e:	00 00       	nop
     120:	10 27       	eor	r17, r16
     122:	00 00       	nop
     124:	00 00       	nop
     126:	e8 03       	fmulsu	r22, r16
     128:	00 00       	nop
     12a:	00 00       	nop
     12c:	64 00       	.word	0x0064	; ????
     12e:	00 00       	nop
     130:	00 00       	nop
     132:	0a 00       	.word	0x000a	; ????
     134:	00 00       	nop
     136:	00 00       	nop
     138:	01 00       	.word	0x0001	; ????
     13a:	00 00       	nop
     13c:	00 00       	nop
     13e:	2c 76       	andi	r18, 0x6C	; 108
     140:	d8 88       	ldd	r13, Y+16	; 0x10
     142:	dc 67       	ori	r29, 0x7C	; 124
     144:	4f 08       	sbc	r4, r15
     146:	23 df       	rcall	.-442    	; 0xffffff8e <__eeprom_end+0xff7eff8e>
     148:	c1 df       	rcall	.-126    	; 0xcc <__SREG__+0x8d>
     14a:	ae 59       	subi	r26, 0x9E	; 158
     14c:	e1 b1       	in	r30, 0x01	; 1
     14e:	b7 96       	adiw	r30, 0x27	; 39
     150:	e5 e3       	ldi	r30, 0x35	; 53
     152:	e4 53       	subi	r30, 0x34	; 52
     154:	c6 3a       	cpi	r28, 0xA6	; 166
     156:	e6 51       	subi	r30, 0x16	; 22
     158:	99 76       	andi	r25, 0x69	; 105
     15a:	96 e8       	ldi	r25, 0x86	; 134
     15c:	e6 c2       	rjmp	.+1484   	; 0x72a <__vector_26+0x1c>
     15e:	84 26       	eor	r8, r20
     160:	eb 89       	ldd	r30, Y+19	; 0x13
     162:	8c 9b       	sbis	0x11, 4	; 17
     164:	62 ed       	ldi	r22, 0xD2	; 210
     166:	40 7c       	andi	r20, 0xC0	; 192
     168:	6f fc       	.word	0xfc6f	; ????
     16a:	ef bc       	out	0x2f, r14	; 47
     16c:	9c 9f       	mul	r25, r28
     16e:	40 f2       	brcs	.-112    	; 0x100 <__trampolines_end+0x1c>
     170:	ba a5       	ldd	r27, Y+42	; 0x2a
     172:	6f a5       	ldd	r22, Y+47	; 0x2f
     174:	f4 90       	lpm	r15, Z
     176:	05 5a       	subi	r16, 0xA5	; 165
     178:	2a f7       	brpl	.-54     	; 0x144 <__trampolines_end+0x60>
     17a:	5c 93       	st	X, r21
     17c:	6b 6c       	ori	r22, 0xCB	; 203
     17e:	f9 67       	ori	r31, 0x79	; 121
     180:	6d c1       	rjmp	.+730    	; 0x45c <__LOCK_REGION_LENGTH__+0x5c>
     182:	1b fc       	.word	0xfc1b	; ????
     184:	e0 e4       	ldi	r30, 0x40	; 64
     186:	0d 47       	sbci	r16, 0x7D	; 125
     188:	fe f5       	brtc	.+126    	; 0x208 <__do_copy_data+0x8>
     18a:	20 e6       	ldi	r18, 0x60	; 96
     18c:	b5 00       	.word	0x00b5	; ????
     18e:	d0 ed       	ldi	r29, 0xD0	; 208
     190:	90 2e       	mov	r9, r16
     192:	03 00       	.word	0x0003	; ????
     194:	94 35       	cpi	r25, 0x54	; 84
     196:	77 05       	cpc	r23, r7
     198:	00 80       	ld	r0, Z
     19a:	84 1e       	adc	r8, r20
     19c:	08 00       	.word	0x0008	; ????
     19e:	00 20       	and	r0, r0
     1a0:	4e 0a       	sbc	r4, r30
     1a2:	00 00       	nop
     1a4:	00 c8       	rjmp	.-4096   	; 0xfffff1a6 <__eeprom_end+0xff7ef1a6>
     1a6:	0c 33       	cpi	r16, 0x3C	; 60
     1a8:	33 33       	cpi	r19, 0x33	; 51
     1aa:	33 0f       	add	r19, r19
     1ac:	98 6e       	ori	r25, 0xE8	; 232
     1ae:	12 83       	std	Z+2, r17	; 0x02
     1b0:	11 41       	sbci	r17, 0x11	; 17
     1b2:	ef 8d       	ldd	r30, Y+31	; 0x1f
     1b4:	21 14       	cp	r2, r1
     1b6:	89 3b       	cpi	r24, 0xB9	; 185
     1b8:	e6 55       	subi	r30, 0x56	; 86
     1ba:	16 cf       	rjmp	.-468    	; 0xffffffe8 <__eeprom_end+0xff7effe8>
     1bc:	fe e6       	ldi	r31, 0x6E	; 110
     1be:	db 18       	sub	r13, r11
     1c0:	d1 84       	ldd	r13, Z+9	; 0x09
     1c2:	4b 38       	cpi	r20, 0x8B	; 139
     1c4:	1b f7       	brvc	.-58     	; 0x18c <__trampolines_end+0xa8>
     1c6:	7c 1d       	adc	r23, r12
     1c8:	90 1d       	adc	r25, r0
     1ca:	a4 bb       	out	0x14, r26	; 20
     1cc:	e4 24       	eor	r14, r4
     1ce:	20 32       	cpi	r18, 0x20	; 32
     1d0:	84 72       	andi	r24, 0x24	; 36
     1d2:	5e 22       	and	r5, r30
     1d4:	81 00       	.word	0x0081	; ????
     1d6:	c9 f1       	breq	.+114    	; 0x24a <_ZN5Print5writeEPKhj+0xa>
     1d8:	24 ec       	ldi	r18, 0xC4	; 196
     1da:	a1 e5       	ldi	r26, 0x51	; 81
     1dc:	3d 27       	eor	r19, r29

000001de <__ctors_start>:
     1de:	15 05       	cpc	r17, r5

000001e0 <__ctors_end>:
     1e0:	11 24       	eor	r1, r1
     1e2:	1f be       	out	0x3f, r1	; 63
     1e4:	cf ef       	ldi	r28, 0xFF	; 255
     1e6:	d1 e2       	ldi	r29, 0x21	; 33
     1e8:	de bf       	out	0x3e, r29	; 62
     1ea:	cd bf       	out	0x3d, r28	; 61
     1ec:	00 e0       	ldi	r16, 0x00	; 0
     1ee:	0c bf       	out	0x3c, r16	; 60

000001f0 <__do_clear_bss>:
     1f0:	22 e0       	ldi	r18, 0x02	; 2
     1f2:	a0 e4       	ldi	r26, 0x40	; 64
     1f4:	b2 e0       	ldi	r27, 0x02	; 2
     1f6:	01 c0       	rjmp	.+2      	; 0x1fa <.do_clear_bss_start>

000001f8 <.do_clear_bss_loop>:
     1f8:	1d 92       	st	X+, r1

000001fa <.do_clear_bss_start>:
     1fa:	ac 3e       	cpi	r26, 0xEC	; 236
     1fc:	b2 07       	cpc	r27, r18
     1fe:	e1 f7       	brne	.-8      	; 0x1f8 <.do_clear_bss_loop>

00000200 <__do_copy_data>:
     200:	12 e0       	ldi	r17, 0x02	; 2
     202:	a0 e0       	ldi	r26, 0x00	; 0
     204:	b2 e0       	ldi	r27, 0x02	; 2
     206:	ea ed       	ldi	r30, 0xDA	; 218
     208:	f4 e1       	ldi	r31, 0x14	; 20
     20a:	00 e0       	ldi	r16, 0x00	; 0
     20c:	0b bf       	out	0x3b, r16	; 59
     20e:	02 c0       	rjmp	.+4      	; 0x214 <__do_copy_data+0x14>
     210:	07 90       	elpm	r0, Z+
     212:	0d 92       	st	X+, r0
     214:	a0 34       	cpi	r26, 0x40	; 64
     216:	b1 07       	cpc	r27, r17
     218:	d9 f7       	brne	.-10     	; 0x210 <__do_copy_data+0x10>

0000021a <__do_global_ctors>:
     21a:	10 e0       	ldi	r17, 0x00	; 0
     21c:	c0 ef       	ldi	r28, 0xF0	; 240
     21e:	d0 e0       	ldi	r29, 0x00	; 0
     220:	00 e0       	ldi	r16, 0x00	; 0
     222:	05 c0       	rjmp	.+10     	; 0x22e <__do_global_ctors+0x14>
     224:	21 97       	sbiw	r28, 0x01	; 1
     226:	01 09       	sbc	r16, r1
     228:	80 2f       	mov	r24, r16
     22a:	fe 01       	movw	r30, r28
     22c:	37 d7       	rcall	.+3694   	; 0x109c <__tablejump2__>
     22e:	cf 3e       	cpi	r28, 0xEF	; 239
     230:	d1 07       	cpc	r29, r17
     232:	80 e0       	ldi	r24, 0x00	; 0
     234:	08 07       	cpc	r16, r24
     236:	b1 f7       	brne	.-20     	; 0x224 <__do_global_ctors+0xa>
     238:	c9 d2       	rcall	.+1426   	; 0x7cc <main>
     23a:	0c 94 6b 0a 	jmp	0x14d6	; 0x14d6 <_exit>

0000023e <__bad_interrupt>:
     23e:	e0 ce       	rjmp	.-576    	; 0x0 <__vectors>

00000240 <_ZN5Print5writeEPKhj>:

// Public Methods //////////////////////////////////////////////////////////////

/* default implementation: may be overridden */
size_t Print::write(const uint8_t *buffer, size_t size)
{
     240:	cf 92       	push	r12
     242:	df 92       	push	r13
     244:	ef 92       	push	r14
     246:	ff 92       	push	r15
     248:	0f 93       	push	r16
     24a:	1f 93       	push	r17
     24c:	cf 93       	push	r28
     24e:	df 93       	push	r29
     250:	6c 01       	movw	r12, r24
     252:	7a 01       	movw	r14, r20
     254:	8b 01       	movw	r16, r22
  size_t n = 0;
     256:	c0 e0       	ldi	r28, 0x00	; 0
     258:	d0 e0       	ldi	r29, 0x00	; 0
  while (size--) {
     25a:	ce 15       	cp	r28, r14
     25c:	df 05       	cpc	r29, r15
     25e:	81 f0       	breq	.+32     	; 0x280 <_ZN5Print5writeEPKhj+0x40>
    if (write(*buffer++)) n++;
     260:	d8 01       	movw	r26, r16
     262:	6d 91       	ld	r22, X+
     264:	8d 01       	movw	r16, r26
     266:	d6 01       	movw	r26, r12
     268:	ed 91       	ld	r30, X+
     26a:	fc 91       	ld	r31, X
     26c:	01 90       	ld	r0, Z+
     26e:	f0 81       	ld	r31, Z
     270:	e0 2d       	mov	r30, r0
     272:	c6 01       	movw	r24, r12
     274:	19 95       	eicall
     276:	89 2b       	or	r24, r25
     278:	11 f0       	breq	.+4      	; 0x27e <_ZN5Print5writeEPKhj+0x3e>
     27a:	21 96       	adiw	r28, 0x01	; 1
     27c:	ee cf       	rjmp	.-36     	; 0x25a <_ZN5Print5writeEPKhj+0x1a>
     27e:	7e 01       	movw	r14, r28
    else break;
  }
  return n;
}
     280:	c7 01       	movw	r24, r14
     282:	df 91       	pop	r29
     284:	cf 91       	pop	r28
     286:	1f 91       	pop	r17
     288:	0f 91       	pop	r16
     28a:	ff 90       	pop	r15
     28c:	ef 90       	pop	r14
     28e:	df 90       	pop	r13
     290:	cf 90       	pop	r12
     292:	08 95       	ret

00000294 <_ZN5Print5flushEv>:
    size_t println(unsigned long, int = DEC);
    size_t println(double, int = 2);
    size_t println(const Printable&);
    size_t println(void);

    virtual void flush() { /* Empty implementation for backward compatibility */ }
     294:	08 95       	ret

00000296 <_ZN5Print17availableForWriteEv>:
      return write((const uint8_t *)buffer, size);
    }

    // default to zero, meaning "a single write may block"
    // should be overriden by subclasses with buffering
    virtual int availableForWrite() { return 0; }
     296:	80 e0       	ldi	r24, 0x00	; 0
     298:	90 e0       	ldi	r25, 0x00	; 0
     29a:	08 95       	ret

0000029c <_ZN14HardwareSerial17availableForWriteEv>:
{
  tx_buffer_index_t head;
  tx_buffer_index_t tail;

  TX_BUFFER_ATOMIC {
    head = _tx_buffer_head;
     29c:	fc 01       	movw	r30, r24
     29e:	53 8d       	ldd	r21, Z+27	; 0x1b
    tail = _tx_buffer_tail;
     2a0:	44 8d       	ldd	r20, Z+28	; 0x1c
     2a2:	25 2f       	mov	r18, r21
     2a4:	30 e0       	ldi	r19, 0x00	; 0
     2a6:	84 2f       	mov	r24, r20
     2a8:	90 e0       	ldi	r25, 0x00	; 0
  }
  if (head >= tail) return SERIAL_TX_BUFFER_SIZE - 1 - head + tail;
     2aa:	82 1b       	sub	r24, r18
     2ac:	93 0b       	sbc	r25, r19
     2ae:	54 17       	cp	r21, r20
     2b0:	10 f0       	brcs	.+4      	; 0x2b6 <_ZN14HardwareSerial17availableForWriteEv+0x1a>
     2b2:	cf 96       	adiw	r24, 0x3f	; 63
     2b4:	08 95       	ret
  return tail - head - 1;
     2b6:	01 97       	sbiw	r24, 0x01	; 1
}
     2b8:	08 95       	ret

000002ba <_ZN14HardwareSerial4readEv>:
    return _rx_buffer[_rx_buffer_tail];
  }
}

int HardwareSerial::read(void)
{
     2ba:	fc 01       	movw	r30, r24
  // if the head isn't ahead of the tail, we don't have any characters
  if (_rx_buffer_head == _rx_buffer_tail) {
     2bc:	91 8d       	ldd	r25, Z+25	; 0x19
     2be:	82 8d       	ldd	r24, Z+26	; 0x1a
     2c0:	98 17       	cp	r25, r24
     2c2:	61 f0       	breq	.+24     	; 0x2dc <_ZN14HardwareSerial4readEv+0x22>
    return -1;
  } else {
    unsigned char c = _rx_buffer[_rx_buffer_tail];
     2c4:	82 8d       	ldd	r24, Z+26	; 0x1a
     2c6:	df 01       	movw	r26, r30
     2c8:	a8 0f       	add	r26, r24
     2ca:	b1 1d       	adc	r27, r1
     2cc:	5d 96       	adiw	r26, 0x1d	; 29
     2ce:	8c 91       	ld	r24, X
    _rx_buffer_tail = (rx_buffer_index_t)(_rx_buffer_tail + 1) % SERIAL_RX_BUFFER_SIZE;
     2d0:	92 8d       	ldd	r25, Z+26	; 0x1a
     2d2:	9f 5f       	subi	r25, 0xFF	; 255
     2d4:	9f 73       	andi	r25, 0x3F	; 63
     2d6:	92 8f       	std	Z+26, r25	; 0x1a
    return c;
     2d8:	90 e0       	ldi	r25, 0x00	; 0
     2da:	08 95       	ret

int HardwareSerial::read(void)
{
  // if the head isn't ahead of the tail, we don't have any characters
  if (_rx_buffer_head == _rx_buffer_tail) {
    return -1;
     2dc:	8f ef       	ldi	r24, 0xFF	; 255
     2de:	9f ef       	ldi	r25, 0xFF	; 255
  } else {
    unsigned char c = _rx_buffer[_rx_buffer_tail];
    _rx_buffer_tail = (rx_buffer_index_t)(_rx_buffer_tail + 1) % SERIAL_RX_BUFFER_SIZE;
    return c;
  }
}
     2e0:	08 95       	ret

000002e2 <_ZN6Stream9timedReadEv.constprop.10>:
}

unsigned long millis()
{
	unsigned long m;
	uint8_t oldSREG = SREG;
     2e2:	2f b7       	in	r18, 0x3f	; 63

	// disable interrupts while we read timer0_millis or we might get an
	// inconsistent value (e.g. in the middle of a write to timer0_millis)
	cli();
     2e4:	f8 94       	cli
	m = timer0_millis;
     2e6:	80 91 47 02 	lds	r24, 0x0247	; 0x800247 <timer0_millis>
     2ea:	90 91 48 02 	lds	r25, 0x0248	; 0x800248 <timer0_millis+0x1>
     2ee:	a0 91 49 02 	lds	r26, 0x0249	; 0x800249 <timer0_millis+0x2>
     2f2:	b0 91 4a 02 	lds	r27, 0x024A	; 0x80024a <timer0_millis+0x3>
	SREG = oldSREG;
     2f6:	2f bf       	out	0x3f, r18	; 63

// protected method to read stream with timeout
int Stream::timedRead()
{
  int c;
  _startMillis = millis();
     2f8:	80 93 53 02 	sts	0x0253, r24	; 0x800253 <Serial+0x8>
     2fc:	90 93 54 02 	sts	0x0254, r25	; 0x800254 <Serial+0x9>
     300:	a0 93 55 02 	sts	0x0255, r26	; 0x800255 <Serial+0xa>
     304:	b0 93 56 02 	sts	0x0256, r27	; 0x800256 <Serial+0xb>
  do {
    c = read();
     308:	8b e4       	ldi	r24, 0x4B	; 75
     30a:	92 e0       	ldi	r25, 0x02	; 2
     30c:	d6 df       	rcall	.-84     	; 0x2ba <_ZN14HardwareSerial4readEv>
    if (c >= 0) return c;
     30e:	97 ff       	sbrs	r25, 7
     310:	26 c0       	rjmp	.+76     	; 0x35e <_ZN6Stream9timedReadEv.constprop.10+0x7c>
}

unsigned long millis()
{
	unsigned long m;
	uint8_t oldSREG = SREG;
     312:	2f b7       	in	r18, 0x3f	; 63

	// disable interrupts while we read timer0_millis or we might get an
	// inconsistent value (e.g. in the middle of a write to timer0_millis)
	cli();
     314:	f8 94       	cli
	m = timer0_millis;
     316:	80 91 47 02 	lds	r24, 0x0247	; 0x800247 <timer0_millis>
     31a:	90 91 48 02 	lds	r25, 0x0248	; 0x800248 <timer0_millis+0x1>
     31e:	a0 91 49 02 	lds	r26, 0x0249	; 0x800249 <timer0_millis+0x2>
     322:	b0 91 4a 02 	lds	r27, 0x024A	; 0x80024a <timer0_millis+0x3>
	SREG = oldSREG;
     326:	2f bf       	out	0x3f, r18	; 63
// protected method to read stream with timeout
int Stream::timedRead()
{
  int c;
  _startMillis = millis();
  do {
     328:	40 91 53 02 	lds	r20, 0x0253	; 0x800253 <Serial+0x8>
     32c:	50 91 54 02 	lds	r21, 0x0254	; 0x800254 <Serial+0x9>
     330:	60 91 55 02 	lds	r22, 0x0255	; 0x800255 <Serial+0xa>
     334:	70 91 56 02 	lds	r23, 0x0256	; 0x800256 <Serial+0xb>
     338:	84 1b       	sub	r24, r20
     33a:	95 0b       	sbc	r25, r21
     33c:	a6 0b       	sbc	r26, r22
     33e:	b7 0b       	sbc	r27, r23
     340:	40 91 4f 02 	lds	r20, 0x024F	; 0x80024f <Serial+0x4>
     344:	50 91 50 02 	lds	r21, 0x0250	; 0x800250 <Serial+0x5>
     348:	60 91 51 02 	lds	r22, 0x0251	; 0x800251 <Serial+0x6>
     34c:	70 91 52 02 	lds	r23, 0x0252	; 0x800252 <Serial+0x7>
     350:	84 17       	cp	r24, r20
     352:	95 07       	cpc	r25, r21
     354:	a6 07       	cpc	r26, r22
     356:	b7 07       	cpc	r27, r23
     358:	b8 f2       	brcs	.-82     	; 0x308 <_ZN6Stream9timedReadEv.constprop.10+0x26>
    c = read();
    if (c >= 0) return c;
  } while(millis() - _startMillis < _timeout);
  return -1;     // -1 indicates timeout
     35a:	8f ef       	ldi	r24, 0xFF	; 255
     35c:	9f ef       	ldi	r25, 0xFF	; 255
}
     35e:	08 95       	ret

00000360 <_ZN14HardwareSerial4peekEv>:
{
  return ((unsigned int)(SERIAL_RX_BUFFER_SIZE + _rx_buffer_head - _rx_buffer_tail)) % SERIAL_RX_BUFFER_SIZE;
}

int HardwareSerial::peek(void)
{
     360:	fc 01       	movw	r30, r24
  if (_rx_buffer_head == _rx_buffer_tail) {
     362:	91 8d       	ldd	r25, Z+25	; 0x19
     364:	82 8d       	ldd	r24, Z+26	; 0x1a
     366:	98 17       	cp	r25, r24
     368:	31 f0       	breq	.+12     	; 0x376 <_ZN14HardwareSerial4peekEv+0x16>
    return -1;
  } else {
    return _rx_buffer[_rx_buffer_tail];
     36a:	82 8d       	ldd	r24, Z+26	; 0x1a
     36c:	e8 0f       	add	r30, r24
     36e:	f1 1d       	adc	r31, r1
     370:	85 8d       	ldd	r24, Z+29	; 0x1d
     372:	90 e0       	ldi	r25, 0x00	; 0
     374:	08 95       	ret
}

int HardwareSerial::peek(void)
{
  if (_rx_buffer_head == _rx_buffer_tail) {
    return -1;
     376:	8f ef       	ldi	r24, 0xFF	; 255
     378:	9f ef       	ldi	r25, 0xFF	; 255
  } else {
    return _rx_buffer[_rx_buffer_tail];
  }
}
     37a:	08 95       	ret

0000037c <_ZN14HardwareSerial9availableEv>:
  // clear any received data
  _rx_buffer_head = _rx_buffer_tail;
}

int HardwareSerial::available(void)
{
     37c:	fc 01       	movw	r30, r24
  return ((unsigned int)(SERIAL_RX_BUFFER_SIZE + _rx_buffer_head - _rx_buffer_tail)) % SERIAL_RX_BUFFER_SIZE;
     37e:	91 8d       	ldd	r25, Z+25	; 0x19
     380:	22 8d       	ldd	r18, Z+26	; 0x1a
     382:	89 2f       	mov	r24, r25
     384:	90 e0       	ldi	r25, 0x00	; 0
     386:	80 5c       	subi	r24, 0xC0	; 192
     388:	9f 4f       	sbci	r25, 0xFF	; 255
     38a:	82 1b       	sub	r24, r18
     38c:	91 09       	sbc	r25, r1
}
     38e:	8f 73       	andi	r24, 0x3F	; 63
     390:	99 27       	eor	r25, r25
     392:	08 95       	ret

00000394 <_Z17Serial0_availablev>:
#endif

// Function that can be weakly referenced by serialEventRun to prevent
// pulling in this file if it's not otherwise used.
bool Serial0_available() {
  return Serial.available();
     394:	8b e4       	ldi	r24, 0x4B	; 75
     396:	92 e0       	ldi	r25, 0x02	; 2
     398:	f1 df       	rcall	.-30     	; 0x37c <_ZN14HardwareSerial9availableEv>
     39a:	21 e0       	ldi	r18, 0x01	; 1
     39c:	89 2b       	or	r24, r25
     39e:	09 f4       	brne	.+2      	; 0x3a2 <_Z17Serial0_availablev+0xe>
     3a0:	20 e0       	ldi	r18, 0x00	; 0
}
     3a2:	82 2f       	mov	r24, r18
     3a4:	08 95       	ret

000003a6 <_ZN14HardwareSerial17_tx_udr_empty_irqEv>:
#endif

// Actual interrupt handlers //////////////////////////////////////////////////////////////

void HardwareSerial::_tx_udr_empty_irq(void)
{
     3a6:	fc 01       	movw	r30, r24
  // If interrupts are enabled, there must be more data in the output
  // buffer. Send the next byte
  unsigned char c = _tx_buffer[_tx_buffer_tail];
     3a8:	84 8d       	ldd	r24, Z+28	; 0x1c
     3aa:	df 01       	movw	r26, r30
     3ac:	a8 0f       	add	r26, r24
     3ae:	b1 1d       	adc	r27, r1
     3b0:	a3 5a       	subi	r26, 0xA3	; 163
     3b2:	bf 4f       	sbci	r27, 0xFF	; 255
     3b4:	2c 91       	ld	r18, X
  _tx_buffer_tail = (_tx_buffer_tail + 1) % SERIAL_TX_BUFFER_SIZE;
     3b6:	84 8d       	ldd	r24, Z+28	; 0x1c
     3b8:	90 e0       	ldi	r25, 0x00	; 0
     3ba:	01 96       	adiw	r24, 0x01	; 1
     3bc:	8f 73       	andi	r24, 0x3F	; 63
     3be:	99 27       	eor	r25, r25
     3c0:	84 8f       	std	Z+28, r24	; 0x1c

  *_udr = c;
     3c2:	a6 89       	ldd	r26, Z+22	; 0x16
     3c4:	b7 89       	ldd	r27, Z+23	; 0x17
     3c6:	2c 93       	st	X, r18
  // location". This makes sure flush() won't return until the bytes
  // actually got written. Other r/w bits are preserved, and zeroes
  // written to the rest.

#ifdef MPCM0
  *_ucsra = ((*_ucsra) & ((1 << U2X0) | (1 << MPCM0))) | (1 << TXC0);
     3c8:	a0 89       	ldd	r26, Z+16	; 0x10
     3ca:	b1 89       	ldd	r27, Z+17	; 0x11
     3cc:	8c 91       	ld	r24, X
     3ce:	83 70       	andi	r24, 0x03	; 3
     3d0:	80 64       	ori	r24, 0x40	; 64
     3d2:	8c 93       	st	X, r24
#else
  *_ucsra = ((*_ucsra) & ((1 << U2X0) | (1 << TXC0)));
#endif

  if (_tx_buffer_head == _tx_buffer_tail) {
     3d4:	93 8d       	ldd	r25, Z+27	; 0x1b
     3d6:	84 8d       	ldd	r24, Z+28	; 0x1c
     3d8:	98 13       	cpse	r25, r24
     3da:	06 c0       	rjmp	.+12     	; 0x3e8 <_ZN14HardwareSerial17_tx_udr_empty_irqEv+0x42>
    // Buffer empty, so disable interrupts
    cbi(*_ucsrb, UDRIE0);
     3dc:	02 88       	ldd	r0, Z+18	; 0x12
     3de:	f3 89       	ldd	r31, Z+19	; 0x13
     3e0:	e0 2d       	mov	r30, r0
     3e2:	80 81       	ld	r24, Z
     3e4:	8f 7d       	andi	r24, 0xDF	; 223
     3e6:	80 83       	st	Z, r24
     3e8:	08 95       	ret

000003ea <_ZN14HardwareSerial5writeEh>:
  // If we get here, nothing is queued anymore (DRIE is disabled) and
  // the hardware finished tranmission (TXC is set).
}

size_t HardwareSerial::write(uint8_t c)
{
     3ea:	ef 92       	push	r14
     3ec:	ff 92       	push	r15
     3ee:	0f 93       	push	r16
     3f0:	1f 93       	push	r17
     3f2:	cf 93       	push	r28
     3f4:	df 93       	push	r29
     3f6:	ec 01       	movw	r28, r24
  _written = true;
     3f8:	81 e0       	ldi	r24, 0x01	; 1
     3fa:	88 8f       	std	Y+24, r24	; 0x18
  // If the buffer and the data register is empty, just write the byte
  // to the data register and be done. This shortcut helps
  // significantly improve the effective datarate at high (>
  // 500kbit/s) bitrates, where interrupt overhead becomes a slowdown.
  if (_tx_buffer_head == _tx_buffer_tail && bit_is_set(*_ucsra, UDRE0)) {
     3fc:	9b 8d       	ldd	r25, Y+27	; 0x1b
     3fe:	8c 8d       	ldd	r24, Y+28	; 0x1c
     400:	98 13       	cpse	r25, r24
     402:	05 c0       	rjmp	.+10     	; 0x40e <__LOCK_REGION_LENGTH__+0xe>
     404:	e8 89       	ldd	r30, Y+16	; 0x10
     406:	f9 89       	ldd	r31, Y+17	; 0x11
     408:	80 81       	ld	r24, Z
     40a:	85 fd       	sbrc	r24, 5
     40c:	25 c0       	rjmp	.+74     	; 0x458 <__LOCK_REGION_LENGTH__+0x58>
     40e:	f6 2e       	mov	r15, r22
      *_ucsra = ((*_ucsra) & ((1 << U2X0) | (1 << TXC0)));
#endif
    }
    return 1;
  }
  tx_buffer_index_t i = (_tx_buffer_head + 1) % SERIAL_TX_BUFFER_SIZE;
     410:	0b 8d       	ldd	r16, Y+27	; 0x1b
     412:	10 e0       	ldi	r17, 0x00	; 0
     414:	0f 5f       	subi	r16, 0xFF	; 255
     416:	1f 4f       	sbci	r17, 0xFF	; 255
     418:	0f 73       	andi	r16, 0x3F	; 63
     41a:	11 27       	eor	r17, r17
     41c:	e0 2e       	mov	r14, r16
	
  // If the output buffer is full, there's nothing for it other than to 
  // wait for the interrupt handler to empty it a bit
  while (i == _tx_buffer_tail) {
     41e:	8c 8d       	ldd	r24, Y+28	; 0x1c
     420:	e8 12       	cpse	r14, r24
     422:	0b c0       	rjmp	.+22     	; 0x43a <__LOCK_REGION_LENGTH__+0x3a>
    if (bit_is_clear(SREG, SREG_I)) {
     424:	0f b6       	in	r0, 0x3f	; 63
     426:	07 fc       	sbrc	r0, 7
     428:	fa cf       	rjmp	.-12     	; 0x41e <__LOCK_REGION_LENGTH__+0x1e>
      // Interrupts are disabled, so we'll have to poll the data
      // register empty flag ourselves. If it is set, pretend an
      // interrupt has happened and call the handler to free up
      // space for us.
      if(bit_is_set(*_ucsra, UDRE0))
     42a:	e8 89       	ldd	r30, Y+16	; 0x10
     42c:	f9 89       	ldd	r31, Y+17	; 0x11
     42e:	80 81       	ld	r24, Z
     430:	85 ff       	sbrs	r24, 5
	_tx_udr_empty_irq();
     432:	f5 cf       	rjmp	.-22     	; 0x41e <__LOCK_REGION_LENGTH__+0x1e>
     434:	ce 01       	movw	r24, r28
     436:	b7 df       	rcall	.-146    	; 0x3a6 <_ZN14HardwareSerial17_tx_udr_empty_irqEv>
     438:	f2 cf       	rjmp	.-28     	; 0x41e <__LOCK_REGION_LENGTH__+0x1e>
    } else {
      // nop, the interrupt handler will free up space for us
    }
  }

  _tx_buffer[_tx_buffer_head] = c;
     43a:	8b 8d       	ldd	r24, Y+27	; 0x1b
     43c:	fe 01       	movw	r30, r28
     43e:	e8 0f       	add	r30, r24
     440:	f1 1d       	adc	r31, r1
     442:	e3 5a       	subi	r30, 0xA3	; 163
     444:	ff 4f       	sbci	r31, 0xFF	; 255
     446:	f0 82       	st	Z, r15

  // make atomic to prevent execution of ISR between setting the
  // head pointer and setting the interrupt flag resulting in buffer
  // retransmission
  ATOMIC_BLOCK(ATOMIC_RESTORESTATE) {
     448:	9f b7       	in	r25, 0x3f	; 63
    return 1;
}

static __inline__ uint8_t __iCliRetVal(void)
{
    cli();
     44a:	f8 94       	cli
    _tx_buffer_head = i;
     44c:	0b 8f       	std	Y+27, r16	; 0x1b
    sbi(*_ucsrb, UDRIE0);
     44e:	ea 89       	ldd	r30, Y+18	; 0x12
     450:	fb 89       	ldd	r31, Y+19	; 0x13
     452:	80 81       	ld	r24, Z
     454:	80 62       	ori	r24, 0x20	; 32
     456:	0a c0       	rjmp	.+20     	; 0x46c <__LOCK_REGION_LENGTH__+0x6c>
    // So writing UDR must happen first.
    // Writing UDR and clearing TC must be done atomically, otherwise
    // interrupts might delay the TXC clear so the byte written to UDR
    // is transmitted (setting TXC) before clearing TXC. Then TXC will
    // be cleared when no bytes are left, causing flush() to hang
    ATOMIC_BLOCK(ATOMIC_RESTORESTATE) {
     458:	9f b7       	in	r25, 0x3f	; 63
     45a:	f8 94       	cli
      *_udr = c;
     45c:	ee 89       	ldd	r30, Y+22	; 0x16
     45e:	ff 89       	ldd	r31, Y+23	; 0x17
     460:	60 83       	st	Z, r22
#ifdef MPCM0
      *_ucsra = ((*_ucsra) & ((1 << U2X0) | (1 << MPCM0))) | (1 << TXC0);
     462:	e8 89       	ldd	r30, Y+16	; 0x10
     464:	f9 89       	ldd	r31, Y+17	; 0x11
     466:	80 81       	ld	r24, Z
     468:	83 70       	andi	r24, 0x03	; 3
     46a:	80 64       	ori	r24, 0x40	; 64
     46c:	80 83       	st	Z, r24
    (void)__s;
}

static __inline__ void __iRestore(const  uint8_t *__s)
{
    SREG = *__s;
     46e:	9f bf       	out	0x3f, r25	; 63
    _tx_buffer_head = i;
    sbi(*_ucsrb, UDRIE0);
  }
  
  return 1;
}
     470:	81 e0       	ldi	r24, 0x01	; 1
     472:	90 e0       	ldi	r25, 0x00	; 0
     474:	df 91       	pop	r29
     476:	cf 91       	pop	r28
     478:	1f 91       	pop	r17
     47a:	0f 91       	pop	r16
     47c:	ff 90       	pop	r15
     47e:	ef 90       	pop	r14
     480:	08 95       	ret

00000482 <_ZN14HardwareSerial5flushEv>:
  if (head >= tail) return SERIAL_TX_BUFFER_SIZE - 1 - head + tail;
  return tail - head - 1;
}

void HardwareSerial::flush()
{
     482:	cf 93       	push	r28
     484:	df 93       	push	r29
     486:	ec 01       	movw	r28, r24
  // If we have never written a byte, no need to flush. This special
  // case is needed since there is no way to force the TXC (transmit
  // complete) bit to 1 during initialization
  if (!_written)
     488:	88 8d       	ldd	r24, Y+24	; 0x18
     48a:	88 23       	and	r24, r24
     48c:	c1 f0       	breq	.+48     	; 0x4be <_ZN14HardwareSerial5flushEv+0x3c>
    return;

  while (bit_is_set(*_ucsrb, UDRIE0) || bit_is_clear(*_ucsra, TXC0)) {
     48e:	ea 89       	ldd	r30, Y+18	; 0x12
     490:	fb 89       	ldd	r31, Y+19	; 0x13
     492:	80 81       	ld	r24, Z
     494:	85 fd       	sbrc	r24, 5
     496:	05 c0       	rjmp	.+10     	; 0x4a2 <_ZN14HardwareSerial5flushEv+0x20>
     498:	a8 89       	ldd	r26, Y+16	; 0x10
     49a:	b9 89       	ldd	r27, Y+17	; 0x11
     49c:	8c 91       	ld	r24, X
     49e:	86 fd       	sbrc	r24, 6
     4a0:	0e c0       	rjmp	.+28     	; 0x4be <_ZN14HardwareSerial5flushEv+0x3c>
    if (bit_is_clear(SREG, SREG_I) && bit_is_set(*_ucsrb, UDRIE0))
     4a2:	0f b6       	in	r0, 0x3f	; 63
     4a4:	07 fc       	sbrc	r0, 7
     4a6:	f5 cf       	rjmp	.-22     	; 0x492 <_ZN14HardwareSerial5flushEv+0x10>
     4a8:	80 81       	ld	r24, Z
     4aa:	85 ff       	sbrs	r24, 5
     4ac:	f2 cf       	rjmp	.-28     	; 0x492 <_ZN14HardwareSerial5flushEv+0x10>
	// Interrupts are globally disabled, but the DR empty
	// interrupt should be enabled, so poll the DR empty flag to
	// prevent deadlock
	if (bit_is_set(*_ucsra, UDRE0))
     4ae:	a8 89       	ldd	r26, Y+16	; 0x10
     4b0:	b9 89       	ldd	r27, Y+17	; 0x11
     4b2:	8c 91       	ld	r24, X
     4b4:	85 ff       	sbrs	r24, 5
	  _tx_udr_empty_irq();
     4b6:	ed cf       	rjmp	.-38     	; 0x492 <_ZN14HardwareSerial5flushEv+0x10>
     4b8:	ce 01       	movw	r24, r28
     4ba:	75 df       	rcall	.-278    	; 0x3a6 <_ZN14HardwareSerial17_tx_udr_empty_irqEv>
     4bc:	e8 cf       	rjmp	.-48     	; 0x48e <_ZN14HardwareSerial5flushEv+0xc>
  }
  // If we get here, nothing is queued anymore (DRIE is disabled) and
  // the hardware finished tranmission (TXC is set).
}
     4be:	df 91       	pop	r29
     4c0:	cf 91       	pop	r28
     4c2:	08 95       	ret

000004c4 <_Z14serialEventRunv>:
#endif

void serialEventRun(void)
{
#if defined(HAVE_HWSERIAL0)
  if (Serial0_available && serialEvent && Serial0_available()) serialEvent();
     4c4:	80 e0       	ldi	r24, 0x00	; 0
     4c6:	90 e0       	ldi	r25, 0x00	; 0
     4c8:	89 2b       	or	r24, r25
     4ca:	19 f0       	breq	.+6      	; 0x4d2 <_Z14serialEventRunv+0xe>
     4cc:	63 df       	rcall	.-314    	; 0x394 <_Z17Serial0_availablev>
     4ce:	81 11       	cpse	r24, r1
     4d0:	25 c0       	rjmp	.+74     	; 0x51c <_Z14serialEventRunv+0x58>
#endif
#if defined(HAVE_HWSERIAL1)
  if (Serial1_available && serialEvent1 && Serial1_available()) serialEvent1();
     4d2:	80 e0       	ldi	r24, 0x00	; 0
     4d4:	90 e0       	ldi	r25, 0x00	; 0
     4d6:	89 2b       	or	r24, r25
     4d8:	41 f0       	breq	.+16     	; 0x4ea <_Z14serialEventRunv+0x26>
     4da:	80 e0       	ldi	r24, 0x00	; 0
     4dc:	90 e0       	ldi	r25, 0x00	; 0
     4de:	89 2b       	or	r24, r25
     4e0:	21 f0       	breq	.+8      	; 0x4ea <_Z14serialEventRunv+0x26>
     4e2:	0e 94 00 00 	call	0	; 0x0 <__vectors>
     4e6:	81 11       	cpse	r24, r1
     4e8:	1c c0       	rjmp	.+56     	; 0x522 <_Z14serialEventRunv+0x5e>
#endif
#if defined(HAVE_HWSERIAL2)
  if (Serial2_available && serialEvent2 && Serial2_available()) serialEvent2();
     4ea:	80 e0       	ldi	r24, 0x00	; 0
     4ec:	90 e0       	ldi	r25, 0x00	; 0
     4ee:	89 2b       	or	r24, r25
     4f0:	41 f0       	breq	.+16     	; 0x502 <_Z14serialEventRunv+0x3e>
     4f2:	80 e0       	ldi	r24, 0x00	; 0
     4f4:	90 e0       	ldi	r25, 0x00	; 0
     4f6:	89 2b       	or	r24, r25
     4f8:	21 f0       	breq	.+8      	; 0x502 <_Z14serialEventRunv+0x3e>
     4fa:	0e 94 00 00 	call	0	; 0x0 <__vectors>
     4fe:	81 11       	cpse	r24, r1
     500:	13 c0       	rjmp	.+38     	; 0x528 <_Z14serialEventRunv+0x64>
#endif
#if defined(HAVE_HWSERIAL3)
  if (Serial3_available && serialEvent3 && Serial3_available()) serialEvent3();
     502:	80 e0       	ldi	r24, 0x00	; 0
     504:	90 e0       	ldi	r25, 0x00	; 0
     506:	89 2b       	or	r24, r25
     508:	a1 f0       	breq	.+40     	; 0x532 <_Z14serialEventRunv+0x6e>
     50a:	80 e0       	ldi	r24, 0x00	; 0
     50c:	90 e0       	ldi	r25, 0x00	; 0
     50e:	89 2b       	or	r24, r25
     510:	81 f0       	breq	.+32     	; 0x532 <_Z14serialEventRunv+0x6e>
     512:	0e 94 00 00 	call	0	; 0x0 <__vectors>
     516:	81 11       	cpse	r24, r1
     518:	0a c0       	rjmp	.+20     	; 0x52e <_Z14serialEventRunv+0x6a>
     51a:	08 95       	ret
#endif

void serialEventRun(void)
{
#if defined(HAVE_HWSERIAL0)
  if (Serial0_available && serialEvent && Serial0_available()) serialEvent();
     51c:	0e 94 00 00 	call	0	; 0x0 <__vectors>
     520:	d8 cf       	rjmp	.-80     	; 0x4d2 <_Z14serialEventRunv+0xe>
#endif
#if defined(HAVE_HWSERIAL1)
  if (Serial1_available && serialEvent1 && Serial1_available()) serialEvent1();
     522:	0e 94 00 00 	call	0	; 0x0 <__vectors>
     526:	e1 cf       	rjmp	.-62     	; 0x4ea <_Z14serialEventRunv+0x26>
#endif
#if defined(HAVE_HWSERIAL2)
  if (Serial2_available && serialEvent2 && Serial2_available()) serialEvent2();
     528:	0e 94 00 00 	call	0	; 0x0 <__vectors>
     52c:	ea cf       	rjmp	.-44     	; 0x502 <_Z14serialEventRunv+0x3e>
#endif
#if defined(HAVE_HWSERIAL3)
  if (Serial3_available && serialEvent3 && Serial3_available()) serialEvent3();
     52e:	0c 94 00 00 	jmp	0	; 0x0 <__vectors>
     532:	08 95       	ret

00000534 <_ZN5Print7printlnEPKc.constprop.11>:
  size_t n = print(s);
  n += println();
  return n;
}

size_t Print::println(const char c[])
     534:	cf 93       	push	r28
     536:	df 93       	push	r29
    int getWriteError() { return write_error; }
    void clearWriteError() { setWriteError(0); }
  
    virtual size_t write(uint8_t) = 0;
    size_t write(const char *str) {
      if (str == NULL) return 0;
     538:	00 97       	sbiw	r24, 0x00	; 0
     53a:	71 f0       	breq	.+28     	; 0x558 <_ZN5Print7printlnEPKc.constprop.11+0x24>
      return write((const uint8_t *)str, strlen(str));
     53c:	fc 01       	movw	r30, r24
     53e:	01 90       	ld	r0, Z+
     540:	00 20       	and	r0, r0
     542:	e9 f7       	brne	.-6      	; 0x53e <_ZN5Print7printlnEPKc.constprop.11+0xa>
     544:	31 97       	sbiw	r30, 0x01	; 1
     546:	af 01       	movw	r20, r30
     548:	48 1b       	sub	r20, r24
     54a:	59 0b       	sbc	r21, r25
     54c:	bc 01       	movw	r22, r24
     54e:	8b e4       	ldi	r24, 0x4B	; 75
     550:	92 e0       	ldi	r25, 0x02	; 2
     552:	76 de       	rcall	.-788    	; 0x240 <_ZN5Print5writeEPKhj>
     554:	ec 01       	movw	r28, r24
     556:	02 c0       	rjmp	.+4      	; 0x55c <_ZN5Print7printlnEPKc.constprop.11+0x28>
    int getWriteError() { return write_error; }
    void clearWriteError() { setWriteError(0); }
  
    virtual size_t write(uint8_t) = 0;
    size_t write(const char *str) {
      if (str == NULL) return 0;
     558:	c0 e0       	ldi	r28, 0x00	; 0
     55a:	d0 e0       	ldi	r29, 0x00	; 0
      return write((const uint8_t *)str, strlen(str));
     55c:	42 e0       	ldi	r20, 0x02	; 2
     55e:	50 e0       	ldi	r21, 0x00	; 0
     560:	68 e1       	ldi	r22, 0x18	; 24
     562:	72 e0       	ldi	r23, 0x02	; 2
     564:	8b e4       	ldi	r24, 0x4B	; 75
     566:	92 e0       	ldi	r25, 0x02	; 2
     568:	6b de       	rcall	.-810    	; 0x240 <_ZN5Print5writeEPKhj>
{
  size_t n = print(c);
  n += println();
  return n;
}
     56a:	8c 0f       	add	r24, r28
     56c:	9d 1f       	adc	r25, r29
     56e:	df 91       	pop	r29
     570:	cf 91       	pop	r28
     572:	08 95       	ret

00000574 <_ZN6String10invalidateEv>:
	capacity = 0;
	len = 0;
}

void String::invalidate(void)
{
     574:	cf 93       	push	r28
     576:	df 93       	push	r29
	if (buffer) free(buffer);
     578:	ec 01       	movw	r28, r24
     57a:	88 81       	ld	r24, Y
     57c:	99 81       	ldd	r25, Y+1	; 0x01
     57e:	00 97       	sbiw	r24, 0x00	; 0
     580:	09 f0       	breq	.+2      	; 0x584 <_ZN6String10invalidateEv+0x10>
     582:	2c d6       	rcall	.+3160   	; 0x11dc <free>
	buffer = NULL;
     584:	19 82       	std	Y+1, r1	; 0x01
	capacity = len = 0;
     586:	18 82       	st	Y, r1
     588:	1d 82       	std	Y+5, r1	; 0x05
     58a:	1c 82       	std	Y+4, r1	; 0x04
     58c:	1b 82       	std	Y+3, r1	; 0x03
}
     58e:	1a 82       	std	Y+2, r1	; 0x02
     590:	df 91       	pop	r29
     592:	cf 91       	pop	r28
extern "C" void __cxa_deleted_virtual(void) __attribute__ ((__noreturn__));

void __cxa_pure_virtual(void) {
  // We might want to write some diagnostics to uart in this case
  //std::terminate();
  abort();
     594:	08 95       	ret

00000596 <__cxa_pure_virtual>:
     596:	8b d7       	rcall	.+3862   	; 0x14ae <abort>

00000598 <_ZN6String7reserveEj>:

unsigned char String::reserve(unsigned int size)
{
     598:	0f 93       	push	r16
     59a:	1f 93       	push	r17
     59c:	cf 93       	push	r28
     59e:	df 93       	push	r29
     5a0:	ec 01       	movw	r28, r24
	if (buffer && capacity >= size) return 1;
     5a2:	88 81       	ld	r24, Y
     5a4:	99 81       	ldd	r25, Y+1	; 0x01
     5a6:	00 97       	sbiw	r24, 0x00	; 0
     5a8:	29 f0       	breq	.+10     	; 0x5b4 <_ZN6String7reserveEj+0x1c>
     5aa:	2a 81       	ldd	r18, Y+2	; 0x02
     5ac:	3b 81       	ldd	r19, Y+3	; 0x03
     5ae:	26 17       	cp	r18, r22
     5b0:	37 07       	cpc	r19, r23
     5b2:	80 f4       	brcc	.+32     	; 0x5d4 <_ZN6String7reserveEj+0x3c>
	return 0;
}

unsigned char String::changeBuffer(unsigned int maxStrLen)
{
	char *newbuffer = (char *)realloc(buffer, maxStrLen + 1);
     5b4:	8b 01       	movw	r16, r22
     5b6:	6f 5f       	subi	r22, 0xFF	; 255
     5b8:	7f 4f       	sbci	r23, 0xFF	; 255
     5ba:	99 d6       	rcall	.+3378   	; 0x12ee <realloc>
	if (newbuffer) {
     5bc:	00 97       	sbiw	r24, 0x00	; 0
     5be:	61 f0       	breq	.+24     	; 0x5d8 <_ZN6String7reserveEj+0x40>
		buffer = newbuffer;
     5c0:	99 83       	std	Y+1, r25	; 0x01
     5c2:	88 83       	st	Y, r24
		capacity = maxStrLen;
     5c4:	1b 83       	std	Y+3, r17	; 0x03
     5c6:	0a 83       	std	Y+2, r16	; 0x02

unsigned char String::reserve(unsigned int size)
{
	if (buffer && capacity >= size) return 1;
	if (changeBuffer(size)) {
		if (len == 0) buffer[0] = 0;
     5c8:	2c 81       	ldd	r18, Y+4	; 0x04
     5ca:	3d 81       	ldd	r19, Y+5	; 0x05
     5cc:	23 2b       	or	r18, r19
     5ce:	11 f4       	brne	.+4      	; 0x5d4 <_ZN6String7reserveEj+0x3c>
     5d0:	fc 01       	movw	r30, r24
     5d2:	10 82       	st	Z, r1
     5d4:	81 e0       	ldi	r24, 0x01	; 1
     5d6:	01 c0       	rjmp	.+2      	; 0x5da <_ZN6String7reserveEj+0x42>
		return 1;
	}
	return 0;
     5d8:	80 e0       	ldi	r24, 0x00	; 0
}
     5da:	df 91       	pop	r29
     5dc:	cf 91       	pop	r28
     5de:	1f 91       	pop	r17
     5e0:	0f 91       	pop	r16
     5e2:	08 95       	ret

000005e4 <_ZN6Stream10readStringEv.constprop.6>:
    index++;
  }
  return index; // return number of characters, not including null terminator
}

String Stream::readString()
     5e4:	ef 92       	push	r14
     5e6:	ff 92       	push	r15
     5e8:	0f 93       	push	r16
     5ea:	1f 93       	push	r17
     5ec:	cf 93       	push	r28
     5ee:	df 93       	push	r29
     5f0:	1f 92       	push	r1
     5f2:	1f 92       	push	r1
     5f4:	cd b7       	in	r28, 0x3d	; 61
     5f6:	de b7       	in	r29, 0x3e	; 62
/*  Memory Management                        */
/*********************************************/

inline void String::init(void)
{
	buffer = NULL;
     5f8:	8c 01       	movw	r16, r24
     5fa:	fc 01       	movw	r30, r24
     5fc:	11 82       	std	Z+1, r1	; 0x01
	capacity = 0;
     5fe:	10 82       	st	Z, r1
	len = 0;
     600:	13 82       	std	Z+3, r1	; 0x03
     602:	12 82       	std	Z+2, r1	; 0x02
/*  Copy and Move                            */
/*********************************************/

String & String::copy(const char *cstr, unsigned int length)
{
	if (!reserve(length)) {
     604:	15 82       	std	Z+5, r1	; 0x05
     606:	14 82       	std	Z+4, r1	; 0x04
     608:	60 e0       	ldi	r22, 0x00	; 0
     60a:	70 e0       	ldi	r23, 0x00	; 0
     60c:	c5 df       	rcall	.-118    	; 0x598 <_ZN6String7reserveEj>
		invalidate();
     60e:	81 11       	cpse	r24, r1
     610:	03 c0       	rjmp	.+6      	; 0x618 <_ZN6Stream10readStringEv.constprop.6+0x34>
     612:	c8 01       	movw	r24, r16
		return *this;
	}
	len = length;
     614:	af df       	rcall	.-162    	; 0x574 <_ZN6String10invalidateEv>
     616:	08 c0       	rjmp	.+16     	; 0x628 <_ZN6Stream10readStringEv.constprop.6+0x44>
     618:	f8 01       	movw	r30, r16
	strcpy(buffer, cstr);
     61a:	15 82       	std	Z+5, r1	; 0x05
     61c:	14 82       	std	Z+4, r1	; 0x04
     61e:	6a e1       	ldi	r22, 0x1A	; 26
     620:	72 e0       	ldi	r23, 0x02	; 2
     622:	80 81       	ld	r24, Z
     624:	91 81       	ldd	r25, Z+1	; 0x01
{
  String ret;
  int c = timedRead();
     626:	50 d7       	rcall	.+3744   	; 0x14c8 <strcpy>
  while (c >= 0)
     628:	5c de       	rcall	.-840    	; 0x2e2 <_ZN6Stream9timedReadEv.constprop.10>
     62a:	97 fd       	sbrc	r25, 7
}

unsigned char String::concat(char c)
{
	char buf[2];
	buf[0] = c;
     62c:	1c c0       	rjmp	.+56     	; 0x666 <_ZN6Stream10readStringEv.constprop.6+0x82>
	buf[1] = 0;
     62e:	89 83       	std	Y+1, r24	; 0x01
	return concat(s.buffer, s.len);
}

unsigned char String::concat(const char *cstr, unsigned int length)
{
	unsigned int newlen = len + length;
     630:	1a 82       	std	Y+2, r1	; 0x02
     632:	f8 01       	movw	r30, r16
     634:	e4 80       	ldd	r14, Z+4	; 0x04
     636:	f5 80       	ldd	r15, Z+5	; 0x05
     638:	ff ef       	ldi	r31, 0xFF	; 255
     63a:	ef 1a       	sub	r14, r31
	if (!cstr) return 0;
	if (length == 0) return 1;
	if (!reserve(newlen)) return 0;
     63c:	ff 0a       	sbc	r15, r31
     63e:	b7 01       	movw	r22, r14
     640:	c8 01       	movw	r24, r16
     642:	aa df       	rcall	.-172    	; 0x598 <_ZN6String7reserveEj>
     644:	88 23       	and	r24, r24
	strcpy(buffer + len, cstr);
     646:	81 f3       	breq	.-32     	; 0x628 <_ZN6Stream10readStringEv.constprop.6+0x44>
     648:	f8 01       	movw	r30, r16
     64a:	20 81       	ld	r18, Z
     64c:	31 81       	ldd	r19, Z+1	; 0x01
     64e:	84 81       	ldd	r24, Z+4	; 0x04
     650:	95 81       	ldd	r25, Z+5	; 0x05
     652:	be 01       	movw	r22, r28
     654:	6f 5f       	subi	r22, 0xFF	; 255
     656:	7f 4f       	sbci	r23, 0xFF	; 255
     658:	82 0f       	add	r24, r18
     65a:	93 1f       	adc	r25, r19
     65c:	35 d7       	rcall	.+3690   	; 0x14c8 <strcpy>
	len = newlen;
     65e:	f8 01       	movw	r30, r16
     660:	f5 82       	std	Z+5, r15	; 0x05
     662:	e4 82       	std	Z+4, r14	; 0x04
     664:	e1 cf       	rjmp	.-62     	; 0x628 <_ZN6Stream10readStringEv.constprop.6+0x44>
  {
    ret += (char)c;
    c = timedRead();
  }
  return ret;
}
     666:	c8 01       	movw	r24, r16
     668:	0f 90       	pop	r0
     66a:	0f 90       	pop	r0
     66c:	df 91       	pop	r29
     66e:	cf 91       	pop	r28
     670:	1f 91       	pop	r17
     672:	0f 91       	pop	r16
     674:	ff 90       	pop	r15
     676:	ef 90       	pop	r14
     678:	08 95       	ret

0000067a <__vector_23>:
#if defined(TIM0_OVF_vect)
ISR(TIM0_OVF_vect)
#else
ISR(TIMER0_OVF_vect)
#endif
{
     67a:	1f 92       	push	r1
     67c:	0f 92       	push	r0
     67e:	0f b6       	in	r0, 0x3f	; 63
     680:	0f 92       	push	r0
     682:	11 24       	eor	r1, r1
     684:	2f 93       	push	r18
     686:	3f 93       	push	r19
     688:	8f 93       	push	r24
     68a:	9f 93       	push	r25
     68c:	af 93       	push	r26
     68e:	bf 93       	push	r27
	// copy these to local variables so they can be stored in registers
	// (volatile variables must be read from memory on every access)
	unsigned long m = timer0_millis;
     690:	80 91 47 02 	lds	r24, 0x0247	; 0x800247 <timer0_millis>
     694:	90 91 48 02 	lds	r25, 0x0248	; 0x800248 <timer0_millis+0x1>
     698:	a0 91 49 02 	lds	r26, 0x0249	; 0x800249 <timer0_millis+0x2>
     69c:	b0 91 4a 02 	lds	r27, 0x024A	; 0x80024a <timer0_millis+0x3>
	unsigned char f = timer0_fract;
     6a0:	30 91 46 02 	lds	r19, 0x0246	; 0x800246 <timer0_fract>

	m += MILLIS_INC;
	f += FRACT_INC;
     6a4:	23 e0       	ldi	r18, 0x03	; 3
     6a6:	23 0f       	add	r18, r19
	if (f >= FRACT_MAX) {
     6a8:	2d 37       	cpi	r18, 0x7D	; 125
     6aa:	20 f4       	brcc	.+8      	; 0x6b4 <__vector_23+0x3a>
	// copy these to local variables so they can be stored in registers
	// (volatile variables must be read from memory on every access)
	unsigned long m = timer0_millis;
	unsigned char f = timer0_fract;

	m += MILLIS_INC;
     6ac:	01 96       	adiw	r24, 0x01	; 1
     6ae:	a1 1d       	adc	r26, r1
     6b0:	b1 1d       	adc	r27, r1
     6b2:	05 c0       	rjmp	.+10     	; 0x6be <__vector_23+0x44>
	f += FRACT_INC;
	if (f >= FRACT_MAX) {
		f -= FRACT_MAX;
     6b4:	26 e8       	ldi	r18, 0x86	; 134
     6b6:	23 0f       	add	r18, r19
		m += 1;
     6b8:	02 96       	adiw	r24, 0x02	; 2
     6ba:	a1 1d       	adc	r26, r1
     6bc:	b1 1d       	adc	r27, r1
	}

	timer0_fract = f;
     6be:	20 93 46 02 	sts	0x0246, r18	; 0x800246 <timer0_fract>
	timer0_millis = m;
     6c2:	80 93 47 02 	sts	0x0247, r24	; 0x800247 <timer0_millis>
     6c6:	90 93 48 02 	sts	0x0248, r25	; 0x800248 <timer0_millis+0x1>
     6ca:	a0 93 49 02 	sts	0x0249, r26	; 0x800249 <timer0_millis+0x2>
     6ce:	b0 93 4a 02 	sts	0x024A, r27	; 0x80024a <timer0_millis+0x3>
	timer0_overflow_count++;
     6d2:	80 91 42 02 	lds	r24, 0x0242	; 0x800242 <timer0_overflow_count>
     6d6:	90 91 43 02 	lds	r25, 0x0243	; 0x800243 <timer0_overflow_count+0x1>
     6da:	a0 91 44 02 	lds	r26, 0x0244	; 0x800244 <timer0_overflow_count+0x2>
     6de:	b0 91 45 02 	lds	r27, 0x0245	; 0x800245 <timer0_overflow_count+0x3>
     6e2:	01 96       	adiw	r24, 0x01	; 1
     6e4:	a1 1d       	adc	r26, r1
     6e6:	b1 1d       	adc	r27, r1
     6e8:	80 93 42 02 	sts	0x0242, r24	; 0x800242 <timer0_overflow_count>
     6ec:	90 93 43 02 	sts	0x0243, r25	; 0x800243 <timer0_overflow_count+0x1>
     6f0:	a0 93 44 02 	sts	0x0244, r26	; 0x800244 <timer0_overflow_count+0x2>
     6f4:	b0 93 45 02 	sts	0x0245, r27	; 0x800245 <timer0_overflow_count+0x3>
}
     6f8:	bf 91       	pop	r27
     6fa:	af 91       	pop	r26
     6fc:	9f 91       	pop	r25
     6fe:	8f 91       	pop	r24
     700:	3f 91       	pop	r19
     702:	2f 91       	pop	r18
     704:	0f 90       	pop	r0
     706:	0f be       	out	0x3f, r0	; 63
     708:	0f 90       	pop	r0
     70a:	1f 90       	pop	r1
     70c:	18 95       	reti

0000070e <__vector_26>:
#elif defined(USART_UDRE_vect)
ISR(USART_UDRE_vect)
#else
  #error "Don't know what the Data Register Empty vector is called for Serial"
#endif
{
     70e:	1f 92       	push	r1
     710:	0f 92       	push	r0
     712:	0f b6       	in	r0, 0x3f	; 63
     714:	0f 92       	push	r0
     716:	11 24       	eor	r1, r1
     718:	0b b6       	in	r0, 0x3b	; 59
     71a:	0f 92       	push	r0
     71c:	2f 93       	push	r18
     71e:	3f 93       	push	r19
     720:	4f 93       	push	r20
     722:	5f 93       	push	r21
     724:	6f 93       	push	r22
     726:	7f 93       	push	r23
     728:	8f 93       	push	r24
     72a:	9f 93       	push	r25
     72c:	af 93       	push	r26
     72e:	bf 93       	push	r27
     730:	ef 93       	push	r30
  Serial._tx_udr_empty_irq();
     732:	ff 93       	push	r31
     734:	8b e4       	ldi	r24, 0x4B	; 75
     736:	92 e0       	ldi	r25, 0x02	; 2
     738:	36 de       	rcall	.-916    	; 0x3a6 <_ZN14HardwareSerial17_tx_udr_empty_irqEv>
}
     73a:	ff 91       	pop	r31
     73c:	ef 91       	pop	r30
     73e:	bf 91       	pop	r27
     740:	af 91       	pop	r26
     742:	9f 91       	pop	r25
     744:	8f 91       	pop	r24
     746:	7f 91       	pop	r23
     748:	6f 91       	pop	r22
     74a:	5f 91       	pop	r21
     74c:	4f 91       	pop	r20
     74e:	3f 91       	pop	r19
     750:	2f 91       	pop	r18
     752:	0f 90       	pop	r0
     754:	0b be       	out	0x3b, r0	; 59
     756:	0f 90       	pop	r0
     758:	0f be       	out	0x3f, r0	; 63
     75a:	0f 90       	pop	r0
     75c:	1f 90       	pop	r1
     75e:	18 95       	reti

00000760 <__vector_25>:
#elif defined(USART_RXC_vect)
  ISR(USART_RXC_vect) // ATmega8
#else
  #error "Don't know what the Data Received vector is called for Serial"
#endif
  {
     760:	1f 92       	push	r1
     762:	0f 92       	push	r0
     764:	0f b6       	in	r0, 0x3f	; 63
     766:	0f 92       	push	r0
     768:	11 24       	eor	r1, r1
     76a:	0b b6       	in	r0, 0x3b	; 59
     76c:	0f 92       	push	r0
     76e:	2f 93       	push	r18
     770:	8f 93       	push	r24
     772:	9f 93       	push	r25
     774:	ef 93       	push	r30
     776:	ff 93       	push	r31

// Actual interrupt handlers //////////////////////////////////////////////////////////////

void HardwareSerial::_rx_complete_irq(void)
{
  if (bit_is_clear(*_ucsra, UPE0)) {
     778:	e0 91 5b 02 	lds	r30, 0x025B	; 0x80025b <Serial+0x10>
     77c:	f0 91 5c 02 	lds	r31, 0x025C	; 0x80025c <Serial+0x11>
     780:	80 81       	ld	r24, Z
     782:	e0 91 61 02 	lds	r30, 0x0261	; 0x800261 <Serial+0x16>
     786:	f0 91 62 02 	lds	r31, 0x0262	; 0x800262 <Serial+0x17>
     78a:	82 fd       	sbrc	r24, 2
     78c:	12 c0       	rjmp	.+36     	; 0x7b2 <__vector_25+0x52>
    // No Parity error, read byte and store it in the buffer if there is
    // room
    unsigned char c = *_udr;
     78e:	90 81       	ld	r25, Z
    rx_buffer_index_t i = (unsigned int)(_rx_buffer_head + 1) % SERIAL_RX_BUFFER_SIZE;
     790:	80 91 64 02 	lds	r24, 0x0264	; 0x800264 <Serial+0x19>
     794:	8f 5f       	subi	r24, 0xFF	; 255
     796:	8f 73       	andi	r24, 0x3F	; 63

    // if we should be storing the received character into the location
    // just before the tail (meaning that the head would advance to the
    // current location of the tail), we're about to overflow the buffer
    // and so we don't write the character or advance the head.
    if (i != _rx_buffer_tail) {
     798:	20 91 65 02 	lds	r18, 0x0265	; 0x800265 <Serial+0x1a>
     79c:	82 17       	cp	r24, r18
     79e:	51 f0       	breq	.+20     	; 0x7b4 <__vector_25+0x54>
      _rx_buffer[_rx_buffer_head] = c;
     7a0:	e0 91 64 02 	lds	r30, 0x0264	; 0x800264 <Serial+0x19>
     7a4:	f0 e0       	ldi	r31, 0x00	; 0
     7a6:	e5 5b       	subi	r30, 0xB5	; 181
     7a8:	fd 4f       	sbci	r31, 0xFD	; 253
     7aa:	95 8f       	std	Z+29, r25	; 0x1d
      _rx_buffer_head = i;
     7ac:	80 93 64 02 	sts	0x0264, r24	; 0x800264 <Serial+0x19>
     7b0:	01 c0       	rjmp	.+2      	; 0x7b4 <__vector_25+0x54>
    }
  } else {
    // Parity error, read byte but discard it
    *_udr;
     7b2:	80 81       	ld	r24, Z
    Serial._rx_complete_irq();
  }
     7b4:	ff 91       	pop	r31
     7b6:	ef 91       	pop	r30
     7b8:	9f 91       	pop	r25
     7ba:	8f 91       	pop	r24
     7bc:	2f 91       	pop	r18
     7be:	0f 90       	pop	r0
     7c0:	0b be       	out	0x3b, r0	; 59
     7c2:	0f 90       	pop	r0
     7c4:	0f be       	out	0x3f, r0	; 63
     7c6:	0f 90       	pop	r0
     7c8:	1f 90       	pop	r1
     7ca:	18 95       	reti

000007cc <main>:

void setupUSB() __attribute__((weak));
void setupUSB() { }

int main(void)
{
     7cc:	cf 93       	push	r28
     7ce:	df 93       	push	r29
     7d0:	cd b7       	in	r28, 0x3d	; 61
     7d2:	de b7       	in	r29, 0x3e	; 62
     7d4:	a7 97       	sbiw	r28, 0x27	; 39
     7d6:	0f b6       	in	r0, 0x3f	; 63
     7d8:	f8 94       	cli
     7da:	de bf       	out	0x3e, r29	; 62
     7dc:	0f be       	out	0x3f, r0	; 63
     7de:	cd bf       	out	0x3d, r28	; 61

void init()
{
	// this needs to be called before setup() or some functions won't
	// work there
	sei();
     7e0:	78 94       	sei
	
	// on the ATmega168, timer 0 is also used for fast hardware pwm
	// (using phase-correct PWM would mean that timer 0 overflowed half as often
	// resulting in different millis() behavior on the ATmega8 and ATmega168)
#if defined(TCCR0A) && defined(WGM01)
	sbi(TCCR0A, WGM01);
     7e2:	84 b5       	in	r24, 0x24	; 36
     7e4:	82 60       	ori	r24, 0x02	; 2
     7e6:	84 bd       	out	0x24, r24	; 36
	sbi(TCCR0A, WGM00);
     7e8:	84 b5       	in	r24, 0x24	; 36
     7ea:	81 60       	ori	r24, 0x01	; 1
     7ec:	84 bd       	out	0x24, r24	; 36
	// this combination is for the standard atmega8
	sbi(TCCR0, CS01);
	sbi(TCCR0, CS00);
#elif defined(TCCR0B) && defined(CS01) && defined(CS00)
	// this combination is for the standard 168/328/1280/2560
	sbi(TCCR0B, CS01);
     7ee:	85 b5       	in	r24, 0x25	; 37
     7f0:	82 60       	ori	r24, 0x02	; 2
     7f2:	85 bd       	out	0x25, r24	; 37
	sbi(TCCR0B, CS00);
     7f4:	85 b5       	in	r24, 0x25	; 37
     7f6:	81 60       	ori	r24, 0x01	; 1
     7f8:	85 bd       	out	0x25, r24	; 37

	// enable timer 0 overflow interrupt
#if defined(TIMSK) && defined(TOIE0)
	sbi(TIMSK, TOIE0);
#elif defined(TIMSK0) && defined(TOIE0)
	sbi(TIMSK0, TOIE0);
     7fa:	80 91 6e 00 	lds	r24, 0x006E	; 0x80006e <__TEXT_REGION_LENGTH__+0x70006e>
     7fe:	81 60       	ori	r24, 0x01	; 1
     800:	80 93 6e 00 	sts	0x006E, r24	; 0x80006e <__TEXT_REGION_LENGTH__+0x70006e>
	// this is better for motors as it ensures an even waveform
	// note, however, that fast pwm mode can achieve a frequency of up
	// 8 MHz (with a 16 MHz clock) at 50% duty cycle

#if defined(TCCR1B) && defined(CS11) && defined(CS10)
	TCCR1B = 0;
     804:	10 92 81 00 	sts	0x0081, r1	; 0x800081 <__TEXT_REGION_LENGTH__+0x700081>

	// set timer 1 prescale factor to 64
	sbi(TCCR1B, CS11);
     808:	80 91 81 00 	lds	r24, 0x0081	; 0x800081 <__TEXT_REGION_LENGTH__+0x700081>
     80c:	82 60       	ori	r24, 0x02	; 2
     80e:	80 93 81 00 	sts	0x0081, r24	; 0x800081 <__TEXT_REGION_LENGTH__+0x700081>
#if F_CPU >= 8000000L
	sbi(TCCR1B, CS10);
     812:	80 91 81 00 	lds	r24, 0x0081	; 0x800081 <__TEXT_REGION_LENGTH__+0x700081>
     816:	81 60       	ori	r24, 0x01	; 1
     818:	80 93 81 00 	sts	0x0081, r24	; 0x800081 <__TEXT_REGION_LENGTH__+0x700081>
	sbi(TCCR1, CS10);
#endif
#endif
	// put timer 1 in 8-bit phase correct pwm mode
#if defined(TCCR1A) && defined(WGM10)
	sbi(TCCR1A, WGM10);
     81c:	80 91 80 00 	lds	r24, 0x0080	; 0x800080 <__TEXT_REGION_LENGTH__+0x700080>
     820:	81 60       	ori	r24, 0x01	; 1
     822:	80 93 80 00 	sts	0x0080, r24	; 0x800080 <__TEXT_REGION_LENGTH__+0x700080>

	// set timer 2 prescale factor to 64
#if defined(TCCR2) && defined(CS22)
	sbi(TCCR2, CS22);
#elif defined(TCCR2B) && defined(CS22)
	sbi(TCCR2B, CS22);
     826:	80 91 b1 00 	lds	r24, 0x00B1	; 0x8000b1 <__TEXT_REGION_LENGTH__+0x7000b1>
     82a:	84 60       	ori	r24, 0x04	; 4
     82c:	80 93 b1 00 	sts	0x00B1, r24	; 0x8000b1 <__TEXT_REGION_LENGTH__+0x7000b1>

	// configure timer 2 for phase correct pwm (8-bit)
#if defined(TCCR2) && defined(WGM20)
	sbi(TCCR2, WGM20);
#elif defined(TCCR2A) && defined(WGM20)
	sbi(TCCR2A, WGM20);
     830:	80 91 b0 00 	lds	r24, 0x00B0	; 0x8000b0 <__TEXT_REGION_LENGTH__+0x7000b0>
     834:	81 60       	ori	r24, 0x01	; 1
     836:	80 93 b0 00 	sts	0x00B0, r24	; 0x8000b0 <__TEXT_REGION_LENGTH__+0x7000b0>
//#else
	// Timer 2 not finished (may not be present on this CPU)
#endif

#if defined(TCCR3B) && defined(CS31) && defined(WGM30)
	sbi(TCCR3B, CS31);		// set timer 3 prescale factor to 64
     83a:	80 91 91 00 	lds	r24, 0x0091	; 0x800091 <__TEXT_REGION_LENGTH__+0x700091>
     83e:	82 60       	ori	r24, 0x02	; 2
     840:	80 93 91 00 	sts	0x0091, r24	; 0x800091 <__TEXT_REGION_LENGTH__+0x700091>
	sbi(TCCR3B, CS30);
     844:	80 91 91 00 	lds	r24, 0x0091	; 0x800091 <__TEXT_REGION_LENGTH__+0x700091>
     848:	81 60       	ori	r24, 0x01	; 1
     84a:	80 93 91 00 	sts	0x0091, r24	; 0x800091 <__TEXT_REGION_LENGTH__+0x700091>
	sbi(TCCR3A, WGM30);		// put timer 3 in 8-bit phase correct pwm mode
     84e:	80 91 90 00 	lds	r24, 0x0090	; 0x800090 <__TEXT_REGION_LENGTH__+0x700090>
     852:	81 60       	ori	r24, 0x01	; 1
     854:	80 93 90 00 	sts	0x0090, r24	; 0x800090 <__TEXT_REGION_LENGTH__+0x700090>
	sbi(TCCR4D, WGM40);		// put timer 4 in phase- and frequency-correct PWM mode	
	sbi(TCCR4A, PWM4A);		// enable PWM mode for comparator OCR4A
	sbi(TCCR4C, PWM4D);		// enable PWM mode for comparator OCR4D
#else /* beginning of timer4 block for ATMEGA1280 and ATMEGA2560 */
#if defined(TCCR4B) && defined(CS41) && defined(WGM40)
	sbi(TCCR4B, CS41);		// set timer 4 prescale factor to 64
     858:	80 91 a1 00 	lds	r24, 0x00A1	; 0x8000a1 <__TEXT_REGION_LENGTH__+0x7000a1>
     85c:	82 60       	ori	r24, 0x02	; 2
     85e:	80 93 a1 00 	sts	0x00A1, r24	; 0x8000a1 <__TEXT_REGION_LENGTH__+0x7000a1>
	sbi(TCCR4B, CS40);
     862:	80 91 a1 00 	lds	r24, 0x00A1	; 0x8000a1 <__TEXT_REGION_LENGTH__+0x7000a1>
     866:	81 60       	ori	r24, 0x01	; 1
     868:	80 93 a1 00 	sts	0x00A1, r24	; 0x8000a1 <__TEXT_REGION_LENGTH__+0x7000a1>
	sbi(TCCR4A, WGM40);		// put timer 4 in 8-bit phase correct pwm mode
     86c:	80 91 a0 00 	lds	r24, 0x00A0	; 0x8000a0 <__TEXT_REGION_LENGTH__+0x7000a0>
     870:	81 60       	ori	r24, 0x01	; 1
     872:	80 93 a0 00 	sts	0x00A0, r24	; 0x8000a0 <__TEXT_REGION_LENGTH__+0x7000a0>
#endif
#endif /* end timer4 block for ATMEGA1280/2560 and similar */	

#if defined(TCCR5B) && defined(CS51) && defined(WGM50)
	sbi(TCCR5B, CS51);		// set timer 5 prescale factor to 64
     876:	80 91 21 01 	lds	r24, 0x0121	; 0x800121 <__TEXT_REGION_LENGTH__+0x700121>
     87a:	82 60       	ori	r24, 0x02	; 2
     87c:	80 93 21 01 	sts	0x0121, r24	; 0x800121 <__TEXT_REGION_LENGTH__+0x700121>
	sbi(TCCR5B, CS50);
     880:	80 91 21 01 	lds	r24, 0x0121	; 0x800121 <__TEXT_REGION_LENGTH__+0x700121>
     884:	81 60       	ori	r24, 0x01	; 1
     886:	80 93 21 01 	sts	0x0121, r24	; 0x800121 <__TEXT_REGION_LENGTH__+0x700121>
	sbi(TCCR5A, WGM50);		// put timer 5 in 8-bit phase correct pwm mode
     88a:	80 91 20 01 	lds	r24, 0x0120	; 0x800120 <__TEXT_REGION_LENGTH__+0x700120>
     88e:	81 60       	ori	r24, 0x01	; 1
     890:	80 93 20 01 	sts	0x0120, r24	; 0x800120 <__TEXT_REGION_LENGTH__+0x700120>
#endif

#if defined(ADCSRA)
	// set a2d prescaler so we are inside the desired 50-200 KHz range.
	#if F_CPU >= 16000000 // 16 MHz / 128 = 125 KHz
		sbi(ADCSRA, ADPS2);
     894:	80 91 7a 00 	lds	r24, 0x007A	; 0x80007a <__TEXT_REGION_LENGTH__+0x70007a>
     898:	84 60       	ori	r24, 0x04	; 4
     89a:	80 93 7a 00 	sts	0x007A, r24	; 0x80007a <__TEXT_REGION_LENGTH__+0x70007a>
		sbi(ADCSRA, ADPS1);
     89e:	80 91 7a 00 	lds	r24, 0x007A	; 0x80007a <__TEXT_REGION_LENGTH__+0x70007a>
     8a2:	82 60       	ori	r24, 0x02	; 2
     8a4:	80 93 7a 00 	sts	0x007A, r24	; 0x80007a <__TEXT_REGION_LENGTH__+0x70007a>
		sbi(ADCSRA, ADPS0);
     8a8:	80 91 7a 00 	lds	r24, 0x007A	; 0x80007a <__TEXT_REGION_LENGTH__+0x70007a>
     8ac:	81 60       	ori	r24, 0x01	; 1
     8ae:	80 93 7a 00 	sts	0x007A, r24	; 0x80007a <__TEXT_REGION_LENGTH__+0x70007a>
		cbi(ADCSRA, ADPS2);
		cbi(ADCSRA, ADPS1);
		sbi(ADCSRA, ADPS0);
	#endif
	// enable a2d conversions
	sbi(ADCSRA, ADEN);
     8b2:	80 91 7a 00 	lds	r24, 0x007A	; 0x80007a <__TEXT_REGION_LENGTH__+0x70007a>
     8b6:	80 68       	ori	r24, 0x80	; 128
     8b8:	80 93 7a 00 	sts	0x007A, r24	; 0x80007a <__TEXT_REGION_LENGTH__+0x70007a>
	// here so they can be used as normal digital i/o; they will be
	// reconnected in Serial.begin()
#if defined(UCSRB)
	UCSRB = 0;
#elif defined(UCSR0B)
	UCSR0B = 0;
     8bc:	10 92 c1 00 	sts	0x00C1, r1	; 0x8000c1 <__TEXT_REGION_LENGTH__+0x7000c1>

void HardwareSerial::begin(unsigned long baud, byte config)
{
  // Try u2x mode first
  uint16_t baud_setting = (F_CPU / 4 / baud - 1) / 2;
  *_ucsra = 1 << U2X0;
     8c0:	e0 91 5b 02 	lds	r30, 0x025B	; 0x80025b <Serial+0x10>
     8c4:	f0 91 5c 02 	lds	r31, 0x025C	; 0x80025c <Serial+0x11>
     8c8:	82 e0       	ldi	r24, 0x02	; 2
     8ca:	80 83       	st	Z, r24
    *_ucsra = 0;
    baud_setting = (F_CPU / 8 / baud - 1) / 2;
  }

  // assign the baud_setting, a.k.a. ubrr (USART Baud Rate Register)
  *_ubrrh = baud_setting >> 8;
     8cc:	e0 91 57 02 	lds	r30, 0x0257	; 0x800257 <Serial+0xc>
     8d0:	f0 91 58 02 	lds	r31, 0x0258	; 0x800258 <Serial+0xd>
     8d4:	10 82       	st	Z, r1
  *_ubrrl = baud_setting;
     8d6:	e0 91 59 02 	lds	r30, 0x0259	; 0x800259 <Serial+0xe>
     8da:	f0 91 5a 02 	lds	r31, 0x025A	; 0x80025a <Serial+0xf>
     8de:	8f ec       	ldi	r24, 0xCF	; 207
     8e0:	80 83       	st	Z, r24

  _written = false;
     8e2:	10 92 63 02 	sts	0x0263, r1	; 0x800263 <Serial+0x18>

  //set the data bits, parity, and stop bits
#if defined(__AVR_ATmega8__)
  config |= 0x80; // select UCSRC register (shared with UBRRH)
#endif
  *_ucsrc = config;
     8e6:	e0 91 5f 02 	lds	r30, 0x025F	; 0x80025f <Serial+0x14>
     8ea:	f0 91 60 02 	lds	r31, 0x0260	; 0x800260 <Serial+0x15>
     8ee:	86 e0       	ldi	r24, 0x06	; 6
     8f0:	80 83       	st	Z, r24
  
  sbi(*_ucsrb, RXEN0);
     8f2:	e0 91 5d 02 	lds	r30, 0x025D	; 0x80025d <Serial+0x12>
     8f6:	f0 91 5e 02 	lds	r31, 0x025E	; 0x80025e <Serial+0x13>
     8fa:	80 81       	ld	r24, Z
     8fc:	80 61       	ori	r24, 0x10	; 16
     8fe:	80 83       	st	Z, r24
  sbi(*_ucsrb, TXEN0);
     900:	e0 91 5d 02 	lds	r30, 0x025D	; 0x80025d <Serial+0x12>
     904:	f0 91 5e 02 	lds	r31, 0x025E	; 0x80025e <Serial+0x13>
     908:	80 81       	ld	r24, Z
     90a:	88 60       	ori	r24, 0x08	; 8
     90c:	80 83       	st	Z, r24
  sbi(*_ucsrb, RXCIE0);
     90e:	e0 91 5d 02 	lds	r30, 0x025D	; 0x80025d <Serial+0x12>
     912:	f0 91 5e 02 	lds	r31, 0x025E	; 0x80025e <Serial+0x13>
     916:	80 81       	ld	r24, Z
     918:	80 68       	ori	r24, 0x80	; 128
     91a:	80 83       	st	Z, r24
  cbi(*_ucsrb, UDRIE0);
     91c:	e0 91 5d 02 	lds	r30, 0x025D	; 0x80025d <Serial+0x12>
     920:	f0 91 5e 02 	lds	r31, 0x025E	; 0x80025e <Serial+0x13>
     924:	80 81       	ld	r24, Z
     926:	8f 7d       	andi	r24, 0xDF	; 223
     928:	80 83       	st	Z, r24
void setup() {
  Serial.begin(9600);
}

void loop() {
  int n = (Serial.readString()).toInt();
     92a:	ce 01       	movw	r24, r28
     92c:	01 96       	adiw	r24, 0x01	; 1
     92e:	5a de       	rcall	.-844    	; 0x5e4 <_ZN6Stream10readStringEv.constprop.6>
/*  Parsing / Conversion                     */
/*********************************************/

long String::toInt(void) const
{
	if (buffer) return atol(buffer);
     930:	e9 80       	ldd	r14, Y+1	; 0x01
     932:	fa 80       	ldd	r15, Y+2	; 0x02
     934:	e1 14       	cp	r14, r1
     936:	f1 04       	cpc	r15, r1
     938:	19 f0       	breq	.+6      	; 0x940 <main+0x174>
     93a:	c7 01       	movw	r24, r14
     93c:	c2 d0       	rcall	.+388    	; 0xac2 <atol>
     93e:	03 c0       	rjmp	.+6      	; 0x946 <main+0x17a>
	return 0;
     940:	60 e0       	ldi	r22, 0x00	; 0
     942:	70 e0       	ldi	r23, 0x00	; 0
     944:	cb 01       	movw	r24, r22
	*this = dtostrf(value, (decimalPlaces + 2), decimalPlaces, buf);
}

String::~String()
{
	free(buffer);
     946:	8b 01       	movw	r16, r22
     948:	c7 01       	movw	r24, r14
     94a:	48 d4       	rcall	.+2192   	; 0x11dc <free>
     94c:	8c e1       	ldi	r24, 0x1C	; 28
     94e:	e8 2e       	mov	r14, r24
     950:	82 e0       	ldi	r24, 0x02	; 2
     952:	f8 2e       	mov	r15, r24
  
  for(int i = 1; i <= n; i++){
     954:	c7 01       	movw	r24, r14
     956:	8b 51       	subi	r24, 0x1B	; 27
     958:	92 40       	sbci	r25, 0x02	; 2
     95a:	08 17       	cp	r16, r24
     95c:	19 07       	cpc	r17, r25
    Serial.println("Escribe el numero "+i);
     95e:	04 f1       	brlt	.+64     	; 0x9a0 <main+0x1d4>
     960:	c7 01       	movw	r24, r14
    sum += (Serial.readString()).toInt();
     962:	e8 dd       	rcall	.-1072   	; 0x534 <_ZN5Print7printlnEPKc.constprop.11>
     964:	ce 01       	movw	r24, r28
     966:	01 96       	adiw	r24, 0x01	; 1
     968:	3d de       	rcall	.-902    	; 0x5e4 <_ZN6Stream10readStringEv.constprop.6>
/*  Parsing / Conversion                     */
/*********************************************/

long String::toInt(void) const
{
	if (buffer) return atol(buffer);
     96a:	c9 80       	ldd	r12, Y+1	; 0x01
     96c:	da 80       	ldd	r13, Y+2	; 0x02
     96e:	c1 14       	cp	r12, r1
     970:	d1 04       	cpc	r13, r1
     972:	19 f0       	breq	.+6      	; 0x97a <main+0x1ae>
     974:	c6 01       	movw	r24, r12
     976:	a5 d0       	rcall	.+330    	; 0xac2 <atol>
     978:	03 c0       	rjmp	.+6      	; 0x980 <main+0x1b4>
	return 0;
     97a:	60 e0       	ldi	r22, 0x00	; 0
     97c:	70 e0       	ldi	r23, 0x00	; 0
     97e:	cb 01       	movw	r24, r22
     980:	20 91 40 02 	lds	r18, 0x0240	; 0x800240 <__data_end>
     984:	30 91 41 02 	lds	r19, 0x0241	; 0x800241 <__data_end+0x1>
     988:	62 0f       	add	r22, r18
     98a:	73 1f       	adc	r23, r19
     98c:	70 93 41 02 	sts	0x0241, r23	; 0x800241 <__data_end+0x1>
     990:	60 93 40 02 	sts	0x0240, r22	; 0x800240 <__data_end>
	*this = dtostrf(value, (decimalPlaces + 2), decimalPlaces, buf);
}

String::~String()
{
	free(buffer);
     994:	c6 01       	movw	r24, r12
     996:	22 d4       	rcall	.+2116   	; 0x11dc <free>
     998:	8f ef       	ldi	r24, 0xFF	; 255
     99a:	e8 1a       	sub	r14, r24
     99c:	f8 0a       	sbc	r15, r24
  }
  double avg = sum/n;
     99e:	da cf       	rjmp	.-76     	; 0x954 <main+0x188>
     9a0:	80 91 40 02 	lds	r24, 0x0240	; 0x800240 <__data_end>
     9a4:	90 91 41 02 	lds	r25, 0x0241	; 0x800241 <__data_end+0x1>
     9a8:	b8 01       	movw	r22, r16
     9aa:	51 d3       	rcall	.+1698   	; 0x104e <__divmodhi4>
     9ac:	07 2e       	mov	r0, r23
     9ae:	00 0c       	add	r0, r0
     9b0:	88 0b       	sbc	r24, r24
     9b2:	99 0b       	sbc	r25, r25
     9b4:	11 d3       	rcall	.+1570   	; 0xfd8 <__floatsisf>
     9b6:	6b 01       	movw	r12, r22

  Serial.println("El promedio es: ");
     9b8:	7c 01       	movw	r14, r24
     9ba:	8e e2       	ldi	r24, 0x2E	; 46
     9bc:	92 e0       	ldi	r25, 0x02	; 2
     9be:	ba dd       	rcall	.-1164   	; 0x534 <_ZN5Print7printlnEPKc.constprop.11>
/*  Memory Management                        */
/*********************************************/

inline void String::init(void)
{
	buffer = NULL;
     9c0:	1b a2       	std	Y+35, r1	; 0x23
     9c2:	1a a2       	std	Y+34, r1	; 0x22
	capacity = 0;
     9c4:	1d a2       	std	Y+37, r1	; 0x25
	len = 0;
     9c6:	1c a2       	std	Y+36, r1	; 0x24
     9c8:	1f a2       	std	Y+39, r1	; 0x27

String::String(double value, unsigned char decimalPlaces)
{
	init();
	char buf[33];
	*this = dtostrf(value, (decimalPlaces + 2), decimalPlaces, buf);
     9ca:	1e a2       	std	Y+38, r1	; 0x26
     9cc:	8e 01       	movw	r16, r28
     9ce:	0f 5f       	subi	r16, 0xFF	; 255
     9d0:	1f 4f       	sbci	r17, 0xFF	; 255
     9d2:	22 e0       	ldi	r18, 0x02	; 2
     9d4:	44 e0       	ldi	r20, 0x04	; 4
     9d6:	c7 01       	movw	r24, r14
     9d8:	b6 01       	movw	r22, r12
     9da:	54 d0       	rcall	.+168    	; 0xa84 <dtostrf>
     9dc:	7c 01       	movw	r14, r24
}
#endif

String & String::operator = (const char *cstr)
{
	if (cstr) copy(cstr, strlen(cstr));
     9de:	00 97       	sbiw	r24, 0x00	; 0
     9e0:	71 f0       	breq	.+28     	; 0x9fe <main+0x232>
     9e2:	fc 01       	movw	r30, r24
     9e4:	01 90       	ld	r0, Z+
     9e6:	00 20       	and	r0, r0
     9e8:	e9 f7       	brne	.-6      	; 0x9e4 <main+0x218>
     9ea:	31 97       	sbiw	r30, 0x01	; 1
     9ec:	8f 01       	movw	r16, r30
/*  Copy and Move                            */
/*********************************************/

String & String::copy(const char *cstr, unsigned int length)
{
	if (!reserve(length)) {
     9ee:	08 1b       	sub	r16, r24
     9f0:	19 0b       	sbc	r17, r25
     9f2:	b8 01       	movw	r22, r16
     9f4:	ce 01       	movw	r24, r28
     9f6:	82 96       	adiw	r24, 0x22	; 34
     9f8:	cf dd       	rcall	.-1122   	; 0x598 <_ZN6String7reserveEj>
		invalidate();
     9fa:	81 11       	cpse	r24, r1
     9fc:	04 c0       	rjmp	.+8      	; 0xa06 <main+0x23a>
     9fe:	ce 01       	movw	r24, r28
     a00:	82 96       	adiw	r24, 0x22	; 34
		return *this;
	}
	len = length;
     a02:	b8 dd       	rcall	.-1168   	; 0x574 <_ZN6String10invalidateEv>
     a04:	06 c0       	rjmp	.+12     	; 0xa12 <main+0x246>
	strcpy(buffer, cstr);
     a06:	1f a3       	std	Y+39, r17	; 0x27
     a08:	0e a3       	std	Y+38, r16	; 0x26
     a0a:	b7 01       	movw	r22, r14
    }
    virtual size_t write(const uint8_t *buffer, size_t size);
    size_t write(const char *buffer, size_t size) {
      return write((const uint8_t *)buffer, size);
     a0c:	8a a1       	ldd	r24, Y+34	; 0x22
     a0e:	9b a1       	ldd	r25, Y+35	; 0x23
     a10:	5b d5       	rcall	.+2742   	; 0x14c8 <strcpy>
     a12:	4e a1       	ldd	r20, Y+38	; 0x26
     a14:	5f a1       	ldd	r21, Y+39	; 0x27
     a16:	6a a1       	ldd	r22, Y+34	; 0x22
     a18:	7b a1       	ldd	r23, Y+35	; 0x23
     a1a:	8b e4       	ldi	r24, 0x4B	; 75
	*this = dtostrf(value, (decimalPlaces + 2), decimalPlaces, buf);
}

String::~String()
{
	free(buffer);
     a1c:	92 e0       	ldi	r25, 0x02	; 2
     a1e:	10 dc       	rcall	.-2016   	; 0x240 <_ZN5Print5writeEPKhj>
     a20:	8a a1       	ldd	r24, Y+34	; 0x22
     a22:	9b a1       	ldd	r25, Y+35	; 0x23
	
	setup();
    
	for (;;) {
		loop();
		if (serialEventRun) serialEventRun();
     a24:	db d3       	rcall	.+1974   	; 0x11dc <free>
     a26:	4e dd       	rcall	.-1380   	; 0x4c4 <_Z14serialEventRunv>
     a28:	80 cf       	rjmp	.-256    	; 0x92a <main+0x15e>

00000a2a <_GLOBAL__sub_I___vector_25>:
    size_t printNumber(unsigned long, uint8_t);
    size_t printFloat(double, uint8_t);
  protected:
    void setWriteError(int err = 1) { write_error = err; }
  public:
    Print() : write_error(0) {}
     a2a:	eb e4       	ldi	r30, 0x4B	; 75
     a2c:	f2 e0       	ldi	r31, 0x02	; 2
     a2e:	13 82       	std	Z+3, r1	; 0x03
     a30:	12 82       	std	Z+2, r1	; 0x02
  public:
    virtual int available() = 0;
    virtual int read() = 0;
    virtual int peek() = 0;

    Stream() {_timeout=1000;}
     a32:	88 ee       	ldi	r24, 0xE8	; 232
     a34:	93 e0       	ldi	r25, 0x03	; 3
     a36:	a0 e0       	ldi	r26, 0x00	; 0
     a38:	b0 e0       	ldi	r27, 0x00	; 0
     a3a:	84 83       	std	Z+4, r24	; 0x04
     a3c:	95 83       	std	Z+5, r25	; 0x05
     a3e:	a6 83       	std	Z+6, r26	; 0x06
     a40:	b7 83       	std	Z+7, r27	; 0x07
  volatile uint8_t *ucsrc, volatile uint8_t *udr) :
    _ubrrh(ubrrh), _ubrrl(ubrrl),
    _ucsra(ucsra), _ucsrb(ucsrb), _ucsrc(ucsrc),
    _udr(udr),
    _rx_buffer_head(0), _rx_buffer_tail(0),
    _tx_buffer_head(0), _tx_buffer_tail(0)
     a42:	8a e0       	ldi	r24, 0x0A	; 10
     a44:	92 e0       	ldi	r25, 0x02	; 2
     a46:	91 83       	std	Z+1, r25	; 0x01
     a48:	80 83       	st	Z, r24
     a4a:	85 ec       	ldi	r24, 0xC5	; 197
     a4c:	90 e0       	ldi	r25, 0x00	; 0
     a4e:	95 87       	std	Z+13, r25	; 0x0d
     a50:	84 87       	std	Z+12, r24	; 0x0c
     a52:	84 ec       	ldi	r24, 0xC4	; 196
     a54:	90 e0       	ldi	r25, 0x00	; 0
     a56:	97 87       	std	Z+15, r25	; 0x0f
     a58:	86 87       	std	Z+14, r24	; 0x0e
     a5a:	80 ec       	ldi	r24, 0xC0	; 192
     a5c:	90 e0       	ldi	r25, 0x00	; 0
     a5e:	91 8b       	std	Z+17, r25	; 0x11
     a60:	80 8b       	std	Z+16, r24	; 0x10
     a62:	81 ec       	ldi	r24, 0xC1	; 193
     a64:	90 e0       	ldi	r25, 0x00	; 0
     a66:	93 8b       	std	Z+19, r25	; 0x13
     a68:	82 8b       	std	Z+18, r24	; 0x12
     a6a:	82 ec       	ldi	r24, 0xC2	; 194
     a6c:	90 e0       	ldi	r25, 0x00	; 0
     a6e:	95 8b       	std	Z+21, r25	; 0x15
     a70:	84 8b       	std	Z+20, r24	; 0x14
     a72:	86 ec       	ldi	r24, 0xC6	; 198
     a74:	90 e0       	ldi	r25, 0x00	; 0
     a76:	97 8b       	std	Z+23, r25	; 0x17
     a78:	86 8b       	std	Z+22, r24	; 0x16
     a7a:	11 8e       	std	Z+25, r1	; 0x19
     a7c:	12 8e       	std	Z+26, r1	; 0x1a
     a7e:	13 8e       	std	Z+27, r1	; 0x1b
     a80:	14 8e       	std	Z+28, r1	; 0x1c
     a82:	08 95       	ret

00000a84 <dtostrf>:
     a84:	ef 92       	push	r14
     a86:	0f 93       	push	r16
     a88:	1f 93       	push	r17
     a8a:	cf 93       	push	r28
     a8c:	df 93       	push	r29
     a8e:	e8 01       	movw	r28, r16
     a90:	47 fd       	sbrc	r20, 7
     a92:	02 c0       	rjmp	.+4      	; 0xa98 <dtostrf+0x14>
     a94:	34 e0       	ldi	r19, 0x04	; 4
     a96:	01 c0       	rjmp	.+2      	; 0xa9a <dtostrf+0x16>
     a98:	34 e1       	ldi	r19, 0x14	; 20
     a9a:	04 2e       	mov	r0, r20
     a9c:	00 0c       	add	r0, r0
     a9e:	55 0b       	sbc	r21, r21
     aa0:	57 ff       	sbrs	r21, 7
     aa2:	03 c0       	rjmp	.+6      	; 0xaaa <dtostrf+0x26>
     aa4:	51 95       	neg	r21
     aa6:	41 95       	neg	r20
     aa8:	51 09       	sbc	r21, r1
     aaa:	e3 2e       	mov	r14, r19
     aac:	02 2f       	mov	r16, r18
     aae:	24 2f       	mov	r18, r20
     ab0:	ae 01       	movw	r20, r28
     ab2:	42 d0       	rcall	.+132    	; 0xb38 <dtoa_prf>
     ab4:	ce 01       	movw	r24, r28
     ab6:	df 91       	pop	r29
     ab8:	cf 91       	pop	r28
     aba:	1f 91       	pop	r17
     abc:	0f 91       	pop	r16
     abe:	ef 90       	pop	r14
     ac0:	08 95       	ret

00000ac2 <atol>:
     ac2:	1f 93       	push	r17
     ac4:	fc 01       	movw	r30, r24
     ac6:	99 27       	eor	r25, r25
     ac8:	88 27       	eor	r24, r24
     aca:	bc 01       	movw	r22, r24
     acc:	e8 94       	clt
     ace:	11 91       	ld	r17, Z+
     ad0:	10 32       	cpi	r17, 0x20	; 32
     ad2:	e9 f3       	breq	.-6      	; 0xace <atol+0xc>
     ad4:	19 30       	cpi	r17, 0x09	; 9
     ad6:	10 f0       	brcs	.+4      	; 0xadc <atol+0x1a>
     ad8:	1e 30       	cpi	r17, 0x0E	; 14
     ada:	c8 f3       	brcs	.-14     	; 0xace <atol+0xc>
     adc:	1b 32       	cpi	r17, 0x2B	; 43
     ade:	49 f0       	breq	.+18     	; 0xaf2 <atol+0x30>
     ae0:	1d 32       	cpi	r17, 0x2D	; 45
     ae2:	41 f4       	brne	.+16     	; 0xaf4 <atol+0x32>
     ae4:	68 94       	set
     ae6:	05 c0       	rjmp	.+10     	; 0xaf2 <atol+0x30>
     ae8:	12 d0       	rcall	.+36     	; 0xb0e <__mulsi_const_10>
     aea:	61 0f       	add	r22, r17
     aec:	71 1d       	adc	r23, r1
     aee:	81 1d       	adc	r24, r1
     af0:	91 1d       	adc	r25, r1
     af2:	11 91       	ld	r17, Z+
     af4:	10 53       	subi	r17, 0x30	; 48
     af6:	1a 30       	cpi	r17, 0x0A	; 10
     af8:	b8 f3       	brcs	.-18     	; 0xae8 <atol+0x26>
     afa:	3e f4       	brtc	.+14     	; 0xb0a <atol+0x48>
     afc:	90 95       	com	r25
     afe:	80 95       	com	r24
     b00:	70 95       	com	r23
     b02:	61 95       	neg	r22
     b04:	7f 4f       	sbci	r23, 0xFF	; 255
     b06:	8f 4f       	sbci	r24, 0xFF	; 255
     b08:	9f 4f       	sbci	r25, 0xFF	; 255
     b0a:	1f 91       	pop	r17
     b0c:	08 95       	ret

00000b0e <__mulsi_const_10>:
     b0e:	59 2f       	mov	r21, r25
     b10:	48 2f       	mov	r20, r24
     b12:	37 2f       	mov	r19, r23
     b14:	26 2f       	mov	r18, r22
     b16:	66 0f       	add	r22, r22
     b18:	77 1f       	adc	r23, r23
     b1a:	88 1f       	adc	r24, r24
     b1c:	99 1f       	adc	r25, r25
     b1e:	66 0f       	add	r22, r22
     b20:	77 1f       	adc	r23, r23
     b22:	88 1f       	adc	r24, r24
     b24:	99 1f       	adc	r25, r25
     b26:	62 0f       	add	r22, r18
     b28:	73 1f       	adc	r23, r19
     b2a:	84 1f       	adc	r24, r20
     b2c:	95 1f       	adc	r25, r21
     b2e:	66 0f       	add	r22, r22
     b30:	77 1f       	adc	r23, r23
     b32:	88 1f       	adc	r24, r24
     b34:	99 1f       	adc	r25, r25
     b36:	08 95       	ret

00000b38 <dtoa_prf>:
     b38:	8f 92       	push	r8
     b3a:	9f 92       	push	r9
     b3c:	af 92       	push	r10
     b3e:	bf 92       	push	r11
     b40:	cf 92       	push	r12
     b42:	df 92       	push	r13
     b44:	ef 92       	push	r14
     b46:	ff 92       	push	r15
     b48:	0f 93       	push	r16
     b4a:	1f 93       	push	r17
     b4c:	cf 93       	push	r28
     b4e:	df 93       	push	r29
     b50:	cd b7       	in	r28, 0x3d	; 61
     b52:	de b7       	in	r29, 0x3e	; 62
     b54:	29 97       	sbiw	r28, 0x09	; 9
     b56:	0f b6       	in	r0, 0x3f	; 63
     b58:	f8 94       	cli
     b5a:	de bf       	out	0x3e, r29	; 62
     b5c:	0f be       	out	0x3f, r0	; 63
     b5e:	cd bf       	out	0x3d, r28	; 61
     b60:	6a 01       	movw	r12, r20
     b62:	12 2f       	mov	r17, r18
     b64:	b0 2e       	mov	r11, r16
     b66:	2b e3       	ldi	r18, 0x3B	; 59
     b68:	20 17       	cp	r18, r16
     b6a:	20 f0       	brcs	.+8      	; 0xb74 <dtoa_prf+0x3c>
     b6c:	ff 24       	eor	r15, r15
     b6e:	f3 94       	inc	r15
     b70:	f0 0e       	add	r15, r16
     b72:	02 c0       	rjmp	.+4      	; 0xb78 <dtoa_prf+0x40>
     b74:	2c e3       	ldi	r18, 0x3C	; 60
     b76:	f2 2e       	mov	r15, r18
     b78:	0f 2d       	mov	r16, r15
     b7a:	27 e0       	ldi	r18, 0x07	; 7
     b7c:	ae 01       	movw	r20, r28
     b7e:	4f 5f       	subi	r20, 0xFF	; 255
     b80:	5f 4f       	sbci	r21, 0xFF	; 255
     b82:	50 d1       	rcall	.+672    	; 0xe24 <__ftoa_engine>
     b84:	bc 01       	movw	r22, r24
     b86:	49 81       	ldd	r20, Y+1	; 0x01
     b88:	84 2f       	mov	r24, r20
     b8a:	89 70       	andi	r24, 0x09	; 9
     b8c:	81 30       	cpi	r24, 0x01	; 1
     b8e:	31 f0       	breq	.+12     	; 0xb9c <dtoa_prf+0x64>
     b90:	e1 fc       	sbrc	r14, 1
     b92:	06 c0       	rjmp	.+12     	; 0xba0 <dtoa_prf+0x68>
     b94:	e0 fe       	sbrs	r14, 0
     b96:	06 c0       	rjmp	.+12     	; 0xba4 <dtoa_prf+0x6c>
     b98:	90 e2       	ldi	r25, 0x20	; 32
     b9a:	05 c0       	rjmp	.+10     	; 0xba6 <dtoa_prf+0x6e>
     b9c:	9d e2       	ldi	r25, 0x2D	; 45
     b9e:	03 c0       	rjmp	.+6      	; 0xba6 <dtoa_prf+0x6e>
     ba0:	9b e2       	ldi	r25, 0x2B	; 43
     ba2:	01 c0       	rjmp	.+2      	; 0xba6 <dtoa_prf+0x6e>
     ba4:	90 e0       	ldi	r25, 0x00	; 0
     ba6:	5e 2d       	mov	r21, r14
     ba8:	50 71       	andi	r21, 0x10	; 16
     baa:	43 ff       	sbrs	r20, 3
     bac:	3c c0       	rjmp	.+120    	; 0xc26 <dtoa_prf+0xee>
     bae:	91 11       	cpse	r25, r1
     bb0:	02 c0       	rjmp	.+4      	; 0xbb6 <dtoa_prf+0x7e>
     bb2:	83 e0       	ldi	r24, 0x03	; 3
     bb4:	01 c0       	rjmp	.+2      	; 0xbb8 <dtoa_prf+0x80>
     bb6:	84 e0       	ldi	r24, 0x04	; 4
     bb8:	81 17       	cp	r24, r17
     bba:	18 f4       	brcc	.+6      	; 0xbc2 <dtoa_prf+0x8a>
     bbc:	21 2f       	mov	r18, r17
     bbe:	28 1b       	sub	r18, r24
     bc0:	01 c0       	rjmp	.+2      	; 0xbc4 <dtoa_prf+0x8c>
     bc2:	20 e0       	ldi	r18, 0x00	; 0
     bc4:	51 11       	cpse	r21, r1
     bc6:	0b c0       	rjmp	.+22     	; 0xbde <dtoa_prf+0xa6>
     bc8:	f6 01       	movw	r30, r12
     bca:	82 2f       	mov	r24, r18
     bcc:	30 e2       	ldi	r19, 0x20	; 32
     bce:	88 23       	and	r24, r24
     bd0:	19 f0       	breq	.+6      	; 0xbd8 <dtoa_prf+0xa0>
     bd2:	31 93       	st	Z+, r19
     bd4:	81 50       	subi	r24, 0x01	; 1
     bd6:	fb cf       	rjmp	.-10     	; 0xbce <dtoa_prf+0x96>
     bd8:	c2 0e       	add	r12, r18
     bda:	d1 1c       	adc	r13, r1
     bdc:	20 e0       	ldi	r18, 0x00	; 0
     bde:	99 23       	and	r25, r25
     be0:	29 f0       	breq	.+10     	; 0xbec <dtoa_prf+0xb4>
     be2:	d6 01       	movw	r26, r12
     be4:	9c 93       	st	X, r25
     be6:	f6 01       	movw	r30, r12
     be8:	31 96       	adiw	r30, 0x01	; 1
     bea:	6f 01       	movw	r12, r30
     bec:	c6 01       	movw	r24, r12
     bee:	03 96       	adiw	r24, 0x03	; 3
     bf0:	e2 fe       	sbrs	r14, 2
     bf2:	0a c0       	rjmp	.+20     	; 0xc08 <dtoa_prf+0xd0>
     bf4:	3e e4       	ldi	r19, 0x4E	; 78
     bf6:	d6 01       	movw	r26, r12
     bf8:	3c 93       	st	X, r19
     bfa:	41 e4       	ldi	r20, 0x41	; 65
     bfc:	11 96       	adiw	r26, 0x01	; 1
     bfe:	4c 93       	st	X, r20
     c00:	11 97       	sbiw	r26, 0x01	; 1
     c02:	12 96       	adiw	r26, 0x02	; 2
     c04:	3c 93       	st	X, r19
     c06:	06 c0       	rjmp	.+12     	; 0xc14 <dtoa_prf+0xdc>
     c08:	3e e6       	ldi	r19, 0x6E	; 110
     c0a:	f6 01       	movw	r30, r12
     c0c:	30 83       	st	Z, r19
     c0e:	41 e6       	ldi	r20, 0x61	; 97
     c10:	41 83       	std	Z+1, r20	; 0x01
     c12:	32 83       	std	Z+2, r19	; 0x02
     c14:	fc 01       	movw	r30, r24
     c16:	32 2f       	mov	r19, r18
     c18:	40 e2       	ldi	r20, 0x20	; 32
     c1a:	33 23       	and	r19, r19
     c1c:	09 f4       	brne	.+2      	; 0xc20 <dtoa_prf+0xe8>
     c1e:	42 c0       	rjmp	.+132    	; 0xca4 <dtoa_prf+0x16c>
     c20:	41 93       	st	Z+, r20
     c22:	31 50       	subi	r19, 0x01	; 1
     c24:	fa cf       	rjmp	.-12     	; 0xc1a <dtoa_prf+0xe2>
     c26:	42 ff       	sbrs	r20, 2
     c28:	44 c0       	rjmp	.+136    	; 0xcb2 <dtoa_prf+0x17a>
     c2a:	91 11       	cpse	r25, r1
     c2c:	02 c0       	rjmp	.+4      	; 0xc32 <dtoa_prf+0xfa>
     c2e:	83 e0       	ldi	r24, 0x03	; 3
     c30:	01 c0       	rjmp	.+2      	; 0xc34 <dtoa_prf+0xfc>
     c32:	84 e0       	ldi	r24, 0x04	; 4
     c34:	81 17       	cp	r24, r17
     c36:	18 f4       	brcc	.+6      	; 0xc3e <dtoa_prf+0x106>
     c38:	21 2f       	mov	r18, r17
     c3a:	28 1b       	sub	r18, r24
     c3c:	01 c0       	rjmp	.+2      	; 0xc40 <dtoa_prf+0x108>
     c3e:	20 e0       	ldi	r18, 0x00	; 0
     c40:	51 11       	cpse	r21, r1
     c42:	0b c0       	rjmp	.+22     	; 0xc5a <dtoa_prf+0x122>
     c44:	f6 01       	movw	r30, r12
     c46:	82 2f       	mov	r24, r18
     c48:	30 e2       	ldi	r19, 0x20	; 32
     c4a:	88 23       	and	r24, r24
     c4c:	19 f0       	breq	.+6      	; 0xc54 <dtoa_prf+0x11c>
     c4e:	31 93       	st	Z+, r19
     c50:	81 50       	subi	r24, 0x01	; 1
     c52:	fb cf       	rjmp	.-10     	; 0xc4a <dtoa_prf+0x112>
     c54:	c2 0e       	add	r12, r18
     c56:	d1 1c       	adc	r13, r1
     c58:	20 e0       	ldi	r18, 0x00	; 0
     c5a:	99 23       	and	r25, r25
     c5c:	29 f0       	breq	.+10     	; 0xc68 <dtoa_prf+0x130>
     c5e:	d6 01       	movw	r26, r12
     c60:	9c 93       	st	X, r25
     c62:	f6 01       	movw	r30, r12
     c64:	31 96       	adiw	r30, 0x01	; 1
     c66:	6f 01       	movw	r12, r30
     c68:	c6 01       	movw	r24, r12
     c6a:	03 96       	adiw	r24, 0x03	; 3
     c6c:	e2 fe       	sbrs	r14, 2
     c6e:	0b c0       	rjmp	.+22     	; 0xc86 <dtoa_prf+0x14e>
     c70:	39 e4       	ldi	r19, 0x49	; 73
     c72:	d6 01       	movw	r26, r12
     c74:	3c 93       	st	X, r19
     c76:	3e e4       	ldi	r19, 0x4E	; 78
     c78:	11 96       	adiw	r26, 0x01	; 1
     c7a:	3c 93       	st	X, r19
     c7c:	11 97       	sbiw	r26, 0x01	; 1
     c7e:	36 e4       	ldi	r19, 0x46	; 70
     c80:	12 96       	adiw	r26, 0x02	; 2
     c82:	3c 93       	st	X, r19
     c84:	07 c0       	rjmp	.+14     	; 0xc94 <dtoa_prf+0x15c>
     c86:	39 e6       	ldi	r19, 0x69	; 105
     c88:	f6 01       	movw	r30, r12
     c8a:	30 83       	st	Z, r19
     c8c:	3e e6       	ldi	r19, 0x6E	; 110
     c8e:	31 83       	std	Z+1, r19	; 0x01
     c90:	36 e6       	ldi	r19, 0x66	; 102
     c92:	32 83       	std	Z+2, r19	; 0x02
     c94:	fc 01       	movw	r30, r24
     c96:	32 2f       	mov	r19, r18
     c98:	40 e2       	ldi	r20, 0x20	; 32
     c9a:	33 23       	and	r19, r19
     c9c:	19 f0       	breq	.+6      	; 0xca4 <dtoa_prf+0x16c>
     c9e:	41 93       	st	Z+, r20
     ca0:	31 50       	subi	r19, 0x01	; 1
     ca2:	fb cf       	rjmp	.-10     	; 0xc9a <dtoa_prf+0x162>
     ca4:	fc 01       	movw	r30, r24
     ca6:	e2 0f       	add	r30, r18
     ca8:	f1 1d       	adc	r31, r1
     caa:	10 82       	st	Z, r1
     cac:	8e ef       	ldi	r24, 0xFE	; 254
     cae:	9f ef       	ldi	r25, 0xFF	; 255
     cb0:	a6 c0       	rjmp	.+332    	; 0xdfe <dtoa_prf+0x2c6>
     cb2:	21 e0       	ldi	r18, 0x01	; 1
     cb4:	30 e0       	ldi	r19, 0x00	; 0
     cb6:	91 11       	cpse	r25, r1
     cb8:	02 c0       	rjmp	.+4      	; 0xcbe <dtoa_prf+0x186>
     cba:	20 e0       	ldi	r18, 0x00	; 0
     cbc:	30 e0       	ldi	r19, 0x00	; 0
     cbe:	16 16       	cp	r1, r22
     cc0:	17 06       	cpc	r1, r23
     cc2:	1c f4       	brge	.+6      	; 0xcca <dtoa_prf+0x192>
     cc4:	fb 01       	movw	r30, r22
     cc6:	31 96       	adiw	r30, 0x01	; 1
     cc8:	02 c0       	rjmp	.+4      	; 0xcce <dtoa_prf+0x196>
     cca:	e1 e0       	ldi	r30, 0x01	; 1
     ccc:	f0 e0       	ldi	r31, 0x00	; 0
     cce:	2e 0f       	add	r18, r30
     cd0:	3f 1f       	adc	r19, r31
     cd2:	bb 20       	and	r11, r11
     cd4:	21 f0       	breq	.+8      	; 0xcde <dtoa_prf+0x1a6>
     cd6:	eb 2d       	mov	r30, r11
     cd8:	f0 e0       	ldi	r31, 0x00	; 0
     cda:	31 96       	adiw	r30, 0x01	; 1
     cdc:	02 c0       	rjmp	.+4      	; 0xce2 <dtoa_prf+0x1aa>
     cde:	e0 e0       	ldi	r30, 0x00	; 0
     ce0:	f0 e0       	ldi	r31, 0x00	; 0
     ce2:	2e 0f       	add	r18, r30
     ce4:	3f 1f       	adc	r19, r31
     ce6:	e1 2f       	mov	r30, r17
     ce8:	f0 e0       	ldi	r31, 0x00	; 0
     cea:	2e 17       	cp	r18, r30
     cec:	3f 07       	cpc	r19, r31
     cee:	1c f4       	brge	.+6      	; 0xcf6 <dtoa_prf+0x1be>
     cf0:	12 1b       	sub	r17, r18
     cf2:	21 2f       	mov	r18, r17
     cf4:	01 c0       	rjmp	.+2      	; 0xcf8 <dtoa_prf+0x1c0>
     cf6:	20 e0       	ldi	r18, 0x00	; 0
     cf8:	8e 2d       	mov	r24, r14
     cfa:	88 71       	andi	r24, 0x18	; 24
     cfc:	59 f4       	brne	.+22     	; 0xd14 <dtoa_prf+0x1dc>
     cfe:	f6 01       	movw	r30, r12
     d00:	82 2f       	mov	r24, r18
     d02:	30 e2       	ldi	r19, 0x20	; 32
     d04:	88 23       	and	r24, r24
     d06:	19 f0       	breq	.+6      	; 0xd0e <dtoa_prf+0x1d6>
     d08:	31 93       	st	Z+, r19
     d0a:	81 50       	subi	r24, 0x01	; 1
     d0c:	fb cf       	rjmp	.-10     	; 0xd04 <dtoa_prf+0x1cc>
     d0e:	c2 0e       	add	r12, r18
     d10:	d1 1c       	adc	r13, r1
     d12:	20 e0       	ldi	r18, 0x00	; 0
     d14:	99 23       	and	r25, r25
     d16:	29 f0       	breq	.+10     	; 0xd22 <dtoa_prf+0x1ea>
     d18:	d6 01       	movw	r26, r12
     d1a:	9c 93       	st	X, r25
     d1c:	f6 01       	movw	r30, r12
     d1e:	31 96       	adiw	r30, 0x01	; 1
     d20:	6f 01       	movw	r12, r30
     d22:	51 11       	cpse	r21, r1
     d24:	0b c0       	rjmp	.+22     	; 0xd3c <dtoa_prf+0x204>
     d26:	f6 01       	movw	r30, r12
     d28:	82 2f       	mov	r24, r18
     d2a:	90 e3       	ldi	r25, 0x30	; 48
     d2c:	88 23       	and	r24, r24
     d2e:	19 f0       	breq	.+6      	; 0xd36 <dtoa_prf+0x1fe>
     d30:	91 93       	st	Z+, r25
     d32:	81 50       	subi	r24, 0x01	; 1
     d34:	fb cf       	rjmp	.-10     	; 0xd2c <dtoa_prf+0x1f4>
     d36:	c2 0e       	add	r12, r18
     d38:	d1 1c       	adc	r13, r1
     d3a:	20 e0       	ldi	r18, 0x00	; 0
     d3c:	0f 2d       	mov	r16, r15
     d3e:	06 0f       	add	r16, r22
     d40:	9a 81       	ldd	r25, Y+2	; 0x02
     d42:	34 2f       	mov	r19, r20
     d44:	30 71       	andi	r19, 0x10	; 16
     d46:	44 ff       	sbrs	r20, 4
     d48:	03 c0       	rjmp	.+6      	; 0xd50 <dtoa_prf+0x218>
     d4a:	91 33       	cpi	r25, 0x31	; 49
     d4c:	09 f4       	brne	.+2      	; 0xd50 <dtoa_prf+0x218>
     d4e:	01 50       	subi	r16, 0x01	; 1
     d50:	10 16       	cp	r1, r16
     d52:	24 f4       	brge	.+8      	; 0xd5c <dtoa_prf+0x224>
     d54:	09 30       	cpi	r16, 0x09	; 9
     d56:	18 f0       	brcs	.+6      	; 0xd5e <dtoa_prf+0x226>
     d58:	08 e0       	ldi	r16, 0x08	; 8
     d5a:	01 c0       	rjmp	.+2      	; 0xd5e <dtoa_prf+0x226>
     d5c:	01 e0       	ldi	r16, 0x01	; 1
     d5e:	ab 01       	movw	r20, r22
     d60:	77 ff       	sbrs	r23, 7
     d62:	02 c0       	rjmp	.+4      	; 0xd68 <dtoa_prf+0x230>
     d64:	40 e0       	ldi	r20, 0x00	; 0
     d66:	50 e0       	ldi	r21, 0x00	; 0
     d68:	fb 01       	movw	r30, r22
     d6a:	e4 1b       	sub	r30, r20
     d6c:	f5 0b       	sbc	r31, r21
     d6e:	a1 e0       	ldi	r26, 0x01	; 1
     d70:	b0 e0       	ldi	r27, 0x00	; 0
     d72:	ac 0f       	add	r26, r28
     d74:	bd 1f       	adc	r27, r29
     d76:	ea 0f       	add	r30, r26
     d78:	fb 1f       	adc	r31, r27
     d7a:	8e e2       	ldi	r24, 0x2E	; 46
     d7c:	a8 2e       	mov	r10, r24
     d7e:	4b 01       	movw	r8, r22
     d80:	80 1a       	sub	r8, r16
     d82:	91 08       	sbc	r9, r1
     d84:	0b 2d       	mov	r16, r11
     d86:	10 e0       	ldi	r17, 0x00	; 0
     d88:	11 95       	neg	r17
     d8a:	01 95       	neg	r16
     d8c:	11 09       	sbc	r17, r1
     d8e:	4f 3f       	cpi	r20, 0xFF	; 255
     d90:	bf ef       	ldi	r27, 0xFF	; 255
     d92:	5b 07       	cpc	r21, r27
     d94:	21 f4       	brne	.+8      	; 0xd9e <dtoa_prf+0x266>
     d96:	d6 01       	movw	r26, r12
     d98:	ac 92       	st	X, r10
     d9a:	11 96       	adiw	r26, 0x01	; 1
     d9c:	6d 01       	movw	r12, r26
     d9e:	64 17       	cp	r22, r20
     da0:	75 07       	cpc	r23, r21
     da2:	2c f0       	brlt	.+10     	; 0xdae <dtoa_prf+0x276>
     da4:	84 16       	cp	r8, r20
     da6:	95 06       	cpc	r9, r21
     da8:	14 f4       	brge	.+4      	; 0xdae <dtoa_prf+0x276>
     daa:	81 81       	ldd	r24, Z+1	; 0x01
     dac:	01 c0       	rjmp	.+2      	; 0xdb0 <dtoa_prf+0x278>
     dae:	80 e3       	ldi	r24, 0x30	; 48
     db0:	41 50       	subi	r20, 0x01	; 1
     db2:	51 09       	sbc	r21, r1
     db4:	31 96       	adiw	r30, 0x01	; 1
     db6:	d6 01       	movw	r26, r12
     db8:	11 96       	adiw	r26, 0x01	; 1
     dba:	7d 01       	movw	r14, r26
     dbc:	40 17       	cp	r20, r16
     dbe:	51 07       	cpc	r21, r17
     dc0:	24 f0       	brlt	.+8      	; 0xdca <dtoa_prf+0x292>
     dc2:	d6 01       	movw	r26, r12
     dc4:	8c 93       	st	X, r24
     dc6:	67 01       	movw	r12, r14
     dc8:	e2 cf       	rjmp	.-60     	; 0xd8e <dtoa_prf+0x256>
     dca:	64 17       	cp	r22, r20
     dcc:	75 07       	cpc	r23, r21
     dce:	39 f4       	brne	.+14     	; 0xdde <dtoa_prf+0x2a6>
     dd0:	96 33       	cpi	r25, 0x36	; 54
     dd2:	20 f4       	brcc	.+8      	; 0xddc <dtoa_prf+0x2a4>
     dd4:	95 33       	cpi	r25, 0x35	; 53
     dd6:	19 f4       	brne	.+6      	; 0xdde <dtoa_prf+0x2a6>
     dd8:	31 11       	cpse	r19, r1
     dda:	01 c0       	rjmp	.+2      	; 0xdde <dtoa_prf+0x2a6>
     ddc:	81 e3       	ldi	r24, 0x31	; 49
     dde:	f6 01       	movw	r30, r12
     de0:	80 83       	st	Z, r24
     de2:	f7 01       	movw	r30, r14
     de4:	82 2f       	mov	r24, r18
     de6:	90 e2       	ldi	r25, 0x20	; 32
     de8:	88 23       	and	r24, r24
     dea:	19 f0       	breq	.+6      	; 0xdf2 <dtoa_prf+0x2ba>
     dec:	91 93       	st	Z+, r25
     dee:	81 50       	subi	r24, 0x01	; 1
     df0:	fb cf       	rjmp	.-10     	; 0xde8 <dtoa_prf+0x2b0>
     df2:	f7 01       	movw	r30, r14
     df4:	e2 0f       	add	r30, r18
     df6:	f1 1d       	adc	r31, r1
     df8:	10 82       	st	Z, r1
     dfa:	80 e0       	ldi	r24, 0x00	; 0
     dfc:	90 e0       	ldi	r25, 0x00	; 0
     dfe:	29 96       	adiw	r28, 0x09	; 9
     e00:	0f b6       	in	r0, 0x3f	; 63
     e02:	f8 94       	cli
     e04:	de bf       	out	0x3e, r29	; 62
     e06:	0f be       	out	0x3f, r0	; 63
     e08:	cd bf       	out	0x3d, r28	; 61
     e0a:	df 91       	pop	r29
     e0c:	cf 91       	pop	r28
     e0e:	1f 91       	pop	r17
     e10:	0f 91       	pop	r16
     e12:	ff 90       	pop	r15
     e14:	ef 90       	pop	r14
     e16:	df 90       	pop	r13
     e18:	cf 90       	pop	r12
     e1a:	bf 90       	pop	r11
     e1c:	af 90       	pop	r10
     e1e:	9f 90       	pop	r9
     e20:	8f 90       	pop	r8
     e22:	08 95       	ret

00000e24 <__ftoa_engine>:
     e24:	28 30       	cpi	r18, 0x08	; 8
     e26:	08 f0       	brcs	.+2      	; 0xe2a <__ftoa_engine+0x6>
     e28:	27 e0       	ldi	r18, 0x07	; 7
     e2a:	33 27       	eor	r19, r19
     e2c:	da 01       	movw	r26, r20
     e2e:	99 0f       	add	r25, r25
     e30:	31 1d       	adc	r19, r1
     e32:	87 fd       	sbrc	r24, 7
     e34:	91 60       	ori	r25, 0x01	; 1
     e36:	00 96       	adiw	r24, 0x00	; 0
     e38:	61 05       	cpc	r22, r1
     e3a:	71 05       	cpc	r23, r1
     e3c:	39 f4       	brne	.+14     	; 0xe4c <__ftoa_engine+0x28>
     e3e:	32 60       	ori	r19, 0x02	; 2
     e40:	2e 5f       	subi	r18, 0xFE	; 254
     e42:	3d 93       	st	X+, r19
     e44:	30 e3       	ldi	r19, 0x30	; 48
     e46:	2a 95       	dec	r18
     e48:	e1 f7       	brne	.-8      	; 0xe42 <__ftoa_engine+0x1e>
     e4a:	08 95       	ret
     e4c:	9f 3f       	cpi	r25, 0xFF	; 255
     e4e:	30 f0       	brcs	.+12     	; 0xe5c <__ftoa_engine+0x38>
     e50:	80 38       	cpi	r24, 0x80	; 128
     e52:	71 05       	cpc	r23, r1
     e54:	61 05       	cpc	r22, r1
     e56:	09 f0       	breq	.+2      	; 0xe5a <__ftoa_engine+0x36>
     e58:	3c 5f       	subi	r19, 0xFC	; 252
     e5a:	3c 5f       	subi	r19, 0xFC	; 252
     e5c:	3d 93       	st	X+, r19
     e5e:	91 30       	cpi	r25, 0x01	; 1
     e60:	08 f0       	brcs	.+2      	; 0xe64 <__ftoa_engine+0x40>
     e62:	80 68       	ori	r24, 0x80	; 128
     e64:	91 1d       	adc	r25, r1
     e66:	df 93       	push	r29
     e68:	cf 93       	push	r28
     e6a:	1f 93       	push	r17
     e6c:	0f 93       	push	r16
     e6e:	ff 92       	push	r15
     e70:	ef 92       	push	r14
     e72:	19 2f       	mov	r17, r25
     e74:	98 7f       	andi	r25, 0xF8	; 248
     e76:	96 95       	lsr	r25
     e78:	e9 2f       	mov	r30, r25
     e7a:	96 95       	lsr	r25
     e7c:	96 95       	lsr	r25
     e7e:	e9 0f       	add	r30, r25
     e80:	ff 27       	eor	r31, r31
     e82:	e2 5c       	subi	r30, 0xC2	; 194
     e84:	fe 4f       	sbci	r31, 0xFE	; 254
     e86:	99 27       	eor	r25, r25
     e88:	33 27       	eor	r19, r19
     e8a:	ee 24       	eor	r14, r14
     e8c:	ff 24       	eor	r15, r15
     e8e:	a7 01       	movw	r20, r14
     e90:	e7 01       	movw	r28, r14
     e92:	05 90       	lpm	r0, Z+
     e94:	08 94       	sec
     e96:	07 94       	ror	r0
     e98:	28 f4       	brcc	.+10     	; 0xea4 <__ftoa_engine+0x80>
     e9a:	36 0f       	add	r19, r22
     e9c:	e7 1e       	adc	r14, r23
     e9e:	f8 1e       	adc	r15, r24
     ea0:	49 1f       	adc	r20, r25
     ea2:	51 1d       	adc	r21, r1
     ea4:	66 0f       	add	r22, r22
     ea6:	77 1f       	adc	r23, r23
     ea8:	88 1f       	adc	r24, r24
     eaa:	99 1f       	adc	r25, r25
     eac:	06 94       	lsr	r0
     eae:	a1 f7       	brne	.-24     	; 0xe98 <__ftoa_engine+0x74>
     eb0:	05 90       	lpm	r0, Z+
     eb2:	07 94       	ror	r0
     eb4:	28 f4       	brcc	.+10     	; 0xec0 <__ftoa_engine+0x9c>
     eb6:	e7 0e       	add	r14, r23
     eb8:	f8 1e       	adc	r15, r24
     eba:	49 1f       	adc	r20, r25
     ebc:	56 1f       	adc	r21, r22
     ebe:	c1 1d       	adc	r28, r1
     ec0:	77 0f       	add	r23, r23
     ec2:	88 1f       	adc	r24, r24
     ec4:	99 1f       	adc	r25, r25
     ec6:	66 1f       	adc	r22, r22
     ec8:	06 94       	lsr	r0
     eca:	a1 f7       	brne	.-24     	; 0xeb4 <__ftoa_engine+0x90>
     ecc:	05 90       	lpm	r0, Z+
     ece:	07 94       	ror	r0
     ed0:	28 f4       	brcc	.+10     	; 0xedc <__ftoa_engine+0xb8>
     ed2:	f8 0e       	add	r15, r24
     ed4:	49 1f       	adc	r20, r25
     ed6:	56 1f       	adc	r21, r22
     ed8:	c7 1f       	adc	r28, r23
     eda:	d1 1d       	adc	r29, r1
     edc:	88 0f       	add	r24, r24
     ede:	99 1f       	adc	r25, r25
     ee0:	66 1f       	adc	r22, r22
     ee2:	77 1f       	adc	r23, r23
     ee4:	06 94       	lsr	r0
     ee6:	a1 f7       	brne	.-24     	; 0xed0 <__ftoa_engine+0xac>
     ee8:	05 90       	lpm	r0, Z+
     eea:	07 94       	ror	r0
     eec:	20 f4       	brcc	.+8      	; 0xef6 <__ftoa_engine+0xd2>
     eee:	49 0f       	add	r20, r25
     ef0:	56 1f       	adc	r21, r22
     ef2:	c7 1f       	adc	r28, r23
     ef4:	d8 1f       	adc	r29, r24
     ef6:	99 0f       	add	r25, r25
     ef8:	66 1f       	adc	r22, r22
     efa:	77 1f       	adc	r23, r23
     efc:	88 1f       	adc	r24, r24
     efe:	06 94       	lsr	r0
     f00:	a9 f7       	brne	.-22     	; 0xeec <__ftoa_engine+0xc8>
     f02:	84 91       	lpm	r24, Z
     f04:	10 95       	com	r17
     f06:	17 70       	andi	r17, 0x07	; 7
     f08:	41 f0       	breq	.+16     	; 0xf1a <__ftoa_engine+0xf6>
     f0a:	d6 95       	lsr	r29
     f0c:	c7 95       	ror	r28
     f0e:	57 95       	ror	r21
     f10:	47 95       	ror	r20
     f12:	f7 94       	ror	r15
     f14:	e7 94       	ror	r14
     f16:	1a 95       	dec	r17
     f18:	c1 f7       	brne	.-16     	; 0xf0a <__ftoa_engine+0xe6>
     f1a:	e4 ee       	ldi	r30, 0xE4	; 228
     f1c:	f0 e0       	ldi	r31, 0x00	; 0
     f1e:	68 94       	set
     f20:	15 90       	lpm	r1, Z+
     f22:	15 91       	lpm	r17, Z+
     f24:	35 91       	lpm	r19, Z+
     f26:	65 91       	lpm	r22, Z+
     f28:	95 91       	lpm	r25, Z+
     f2a:	05 90       	lpm	r0, Z+
     f2c:	7f e2       	ldi	r23, 0x2F	; 47
     f2e:	73 95       	inc	r23
     f30:	e1 18       	sub	r14, r1
     f32:	f1 0a       	sbc	r15, r17
     f34:	43 0b       	sbc	r20, r19
     f36:	56 0b       	sbc	r21, r22
     f38:	c9 0b       	sbc	r28, r25
     f3a:	d0 09       	sbc	r29, r0
     f3c:	c0 f7       	brcc	.-16     	; 0xf2e <__ftoa_engine+0x10a>
     f3e:	e1 0c       	add	r14, r1
     f40:	f1 1e       	adc	r15, r17
     f42:	43 1f       	adc	r20, r19
     f44:	56 1f       	adc	r21, r22
     f46:	c9 1f       	adc	r28, r25
     f48:	d0 1d       	adc	r29, r0
     f4a:	7e f4       	brtc	.+30     	; 0xf6a <__ftoa_engine+0x146>
     f4c:	70 33       	cpi	r23, 0x30	; 48
     f4e:	11 f4       	brne	.+4      	; 0xf54 <__ftoa_engine+0x130>
     f50:	8a 95       	dec	r24
     f52:	e6 cf       	rjmp	.-52     	; 0xf20 <__ftoa_engine+0xfc>
     f54:	e8 94       	clt
     f56:	01 50       	subi	r16, 0x01	; 1
     f58:	30 f0       	brcs	.+12     	; 0xf66 <__ftoa_engine+0x142>
     f5a:	08 0f       	add	r16, r24
     f5c:	0a f4       	brpl	.+2      	; 0xf60 <__ftoa_engine+0x13c>
     f5e:	00 27       	eor	r16, r16
     f60:	02 17       	cp	r16, r18
     f62:	08 f4       	brcc	.+2      	; 0xf66 <__ftoa_engine+0x142>
     f64:	20 2f       	mov	r18, r16
     f66:	23 95       	inc	r18
     f68:	02 2f       	mov	r16, r18
     f6a:	7a 33       	cpi	r23, 0x3A	; 58
     f6c:	28 f0       	brcs	.+10     	; 0xf78 <__ftoa_engine+0x154>
     f6e:	79 e3       	ldi	r23, 0x39	; 57
     f70:	7d 93       	st	X+, r23
     f72:	2a 95       	dec	r18
     f74:	e9 f7       	brne	.-6      	; 0xf70 <__ftoa_engine+0x14c>
     f76:	10 c0       	rjmp	.+32     	; 0xf98 <__ftoa_engine+0x174>
     f78:	7d 93       	st	X+, r23
     f7a:	2a 95       	dec	r18
     f7c:	89 f6       	brne	.-94     	; 0xf20 <__ftoa_engine+0xfc>
     f7e:	06 94       	lsr	r0
     f80:	97 95       	ror	r25
     f82:	67 95       	ror	r22
     f84:	37 95       	ror	r19
     f86:	17 95       	ror	r17
     f88:	17 94       	ror	r1
     f8a:	e1 18       	sub	r14, r1
     f8c:	f1 0a       	sbc	r15, r17
     f8e:	43 0b       	sbc	r20, r19
     f90:	56 0b       	sbc	r21, r22
     f92:	c9 0b       	sbc	r28, r25
     f94:	d0 09       	sbc	r29, r0
     f96:	98 f0       	brcs	.+38     	; 0xfbe <__ftoa_engine+0x19a>
     f98:	23 95       	inc	r18
     f9a:	7e 91       	ld	r23, -X
     f9c:	73 95       	inc	r23
     f9e:	7a 33       	cpi	r23, 0x3A	; 58
     fa0:	08 f0       	brcs	.+2      	; 0xfa4 <__ftoa_engine+0x180>
     fa2:	70 e3       	ldi	r23, 0x30	; 48
     fa4:	7c 93       	st	X, r23
     fa6:	20 13       	cpse	r18, r16
     fa8:	b8 f7       	brcc	.-18     	; 0xf98 <__ftoa_engine+0x174>
     faa:	7e 91       	ld	r23, -X
     fac:	70 61       	ori	r23, 0x10	; 16
     fae:	7d 93       	st	X+, r23
     fb0:	30 f0       	brcs	.+12     	; 0xfbe <__ftoa_engine+0x19a>
     fb2:	83 95       	inc	r24
     fb4:	71 e3       	ldi	r23, 0x31	; 49
     fb6:	7d 93       	st	X+, r23
     fb8:	70 e3       	ldi	r23, 0x30	; 48
     fba:	2a 95       	dec	r18
     fbc:	e1 f7       	brne	.-8      	; 0xfb6 <__ftoa_engine+0x192>
     fbe:	11 24       	eor	r1, r1
     fc0:	ef 90       	pop	r14
     fc2:	ff 90       	pop	r15
     fc4:	0f 91       	pop	r16
     fc6:	1f 91       	pop	r17
     fc8:	cf 91       	pop	r28
     fca:	df 91       	pop	r29
     fcc:	99 27       	eor	r25, r25
     fce:	87 fd       	sbrc	r24, 7
     fd0:	90 95       	com	r25
     fd2:	08 95       	ret

00000fd4 <__floatunsisf>:
     fd4:	e8 94       	clt
     fd6:	09 c0       	rjmp	.+18     	; 0xfea <__floatsisf+0x12>

00000fd8 <__floatsisf>:
     fd8:	97 fb       	bst	r25, 7
     fda:	3e f4       	brtc	.+14     	; 0xfea <__floatsisf+0x12>
     fdc:	90 95       	com	r25
     fde:	80 95       	com	r24
     fe0:	70 95       	com	r23
     fe2:	61 95       	neg	r22
     fe4:	7f 4f       	sbci	r23, 0xFF	; 255
     fe6:	8f 4f       	sbci	r24, 0xFF	; 255
     fe8:	9f 4f       	sbci	r25, 0xFF	; 255
     fea:	99 23       	and	r25, r25
     fec:	a9 f0       	breq	.+42     	; 0x1018 <__floatsisf+0x40>
     fee:	f9 2f       	mov	r31, r25
     ff0:	96 e9       	ldi	r25, 0x96	; 150
     ff2:	bb 27       	eor	r27, r27
     ff4:	93 95       	inc	r25
     ff6:	f6 95       	lsr	r31
     ff8:	87 95       	ror	r24
     ffa:	77 95       	ror	r23
     ffc:	67 95       	ror	r22
     ffe:	b7 95       	ror	r27
    1000:	f1 11       	cpse	r31, r1
    1002:	f8 cf       	rjmp	.-16     	; 0xff4 <__floatsisf+0x1c>
    1004:	fa f4       	brpl	.+62     	; 0x1044 <__floatsisf+0x6c>
    1006:	bb 0f       	add	r27, r27
    1008:	11 f4       	brne	.+4      	; 0x100e <__floatsisf+0x36>
    100a:	60 ff       	sbrs	r22, 0
    100c:	1b c0       	rjmp	.+54     	; 0x1044 <__floatsisf+0x6c>
    100e:	6f 5f       	subi	r22, 0xFF	; 255
    1010:	7f 4f       	sbci	r23, 0xFF	; 255
    1012:	8f 4f       	sbci	r24, 0xFF	; 255
    1014:	9f 4f       	sbci	r25, 0xFF	; 255
    1016:	16 c0       	rjmp	.+44     	; 0x1044 <__floatsisf+0x6c>
    1018:	88 23       	and	r24, r24
    101a:	11 f0       	breq	.+4      	; 0x1020 <__floatsisf+0x48>
    101c:	96 e9       	ldi	r25, 0x96	; 150
    101e:	11 c0       	rjmp	.+34     	; 0x1042 <__floatsisf+0x6a>
    1020:	77 23       	and	r23, r23
    1022:	21 f0       	breq	.+8      	; 0x102c <__floatsisf+0x54>
    1024:	9e e8       	ldi	r25, 0x8E	; 142
    1026:	87 2f       	mov	r24, r23
    1028:	76 2f       	mov	r23, r22
    102a:	05 c0       	rjmp	.+10     	; 0x1036 <__floatsisf+0x5e>
    102c:	66 23       	and	r22, r22
    102e:	71 f0       	breq	.+28     	; 0x104c <__floatsisf+0x74>
    1030:	96 e8       	ldi	r25, 0x86	; 134
    1032:	86 2f       	mov	r24, r22
    1034:	70 e0       	ldi	r23, 0x00	; 0
    1036:	60 e0       	ldi	r22, 0x00	; 0
    1038:	2a f0       	brmi	.+10     	; 0x1044 <__floatsisf+0x6c>
    103a:	9a 95       	dec	r25
    103c:	66 0f       	add	r22, r22
    103e:	77 1f       	adc	r23, r23
    1040:	88 1f       	adc	r24, r24
    1042:	da f7       	brpl	.-10     	; 0x103a <__floatsisf+0x62>
    1044:	88 0f       	add	r24, r24
    1046:	96 95       	lsr	r25
    1048:	87 95       	ror	r24
    104a:	97 f9       	bld	r25, 7
    104c:	08 95       	ret

0000104e <__divmodhi4>:
    104e:	97 fb       	bst	r25, 7
    1050:	07 2e       	mov	r0, r23
    1052:	16 f4       	brtc	.+4      	; 0x1058 <__divmodhi4+0xa>
    1054:	00 94       	com	r0
    1056:	06 d0       	rcall	.+12     	; 0x1064 <__divmodhi4_neg1>
    1058:	77 fd       	sbrc	r23, 7
    105a:	08 d0       	rcall	.+16     	; 0x106c <__divmodhi4_neg2>
    105c:	0b d0       	rcall	.+22     	; 0x1074 <__udivmodhi4>
    105e:	07 fc       	sbrc	r0, 7
    1060:	05 d0       	rcall	.+10     	; 0x106c <__divmodhi4_neg2>
    1062:	3e f4       	brtc	.+14     	; 0x1072 <__divmodhi4_exit>

00001064 <__divmodhi4_neg1>:
    1064:	90 95       	com	r25
    1066:	81 95       	neg	r24
    1068:	9f 4f       	sbci	r25, 0xFF	; 255
    106a:	08 95       	ret

0000106c <__divmodhi4_neg2>:
    106c:	70 95       	com	r23
    106e:	61 95       	neg	r22
    1070:	7f 4f       	sbci	r23, 0xFF	; 255

00001072 <__divmodhi4_exit>:
    1072:	08 95       	ret

00001074 <__udivmodhi4>:
    1074:	aa 1b       	sub	r26, r26
    1076:	bb 1b       	sub	r27, r27
    1078:	51 e1       	ldi	r21, 0x11	; 17
    107a:	07 c0       	rjmp	.+14     	; 0x108a <__udivmodhi4_ep>

0000107c <__udivmodhi4_loop>:
    107c:	aa 1f       	adc	r26, r26
    107e:	bb 1f       	adc	r27, r27
    1080:	a6 17       	cp	r26, r22
    1082:	b7 07       	cpc	r27, r23
    1084:	10 f0       	brcs	.+4      	; 0x108a <__udivmodhi4_ep>
    1086:	a6 1b       	sub	r26, r22
    1088:	b7 0b       	sbc	r27, r23

0000108a <__udivmodhi4_ep>:
    108a:	88 1f       	adc	r24, r24
    108c:	99 1f       	adc	r25, r25
    108e:	5a 95       	dec	r21
    1090:	a9 f7       	brne	.-22     	; 0x107c <__udivmodhi4_loop>
    1092:	80 95       	com	r24
    1094:	90 95       	com	r25
    1096:	bc 01       	movw	r22, r24
    1098:	cd 01       	movw	r24, r26
    109a:	08 95       	ret

0000109c <__tablejump2__>:
    109c:	ee 0f       	add	r30, r30
    109e:	ff 1f       	adc	r31, r31
    10a0:	88 1f       	adc	r24, r24
    10a2:	8b bf       	out	0x3b, r24	; 59
    10a4:	07 90       	elpm	r0, Z+
    10a6:	f6 91       	elpm	r31, Z
    10a8:	e0 2d       	mov	r30, r0
    10aa:	19 94       	eijmp

000010ac <malloc>:
    10ac:	0f 93       	push	r16
    10ae:	1f 93       	push	r17
    10b0:	cf 93       	push	r28
    10b2:	df 93       	push	r29
    10b4:	82 30       	cpi	r24, 0x02	; 2
    10b6:	91 05       	cpc	r25, r1
    10b8:	10 f4       	brcc	.+4      	; 0x10be <malloc+0x12>
    10ba:	82 e0       	ldi	r24, 0x02	; 2
    10bc:	90 e0       	ldi	r25, 0x00	; 0
    10be:	e0 91 ea 02 	lds	r30, 0x02EA	; 0x8002ea <__flp>
    10c2:	f0 91 eb 02 	lds	r31, 0x02EB	; 0x8002eb <__flp+0x1>
    10c6:	20 e0       	ldi	r18, 0x00	; 0
    10c8:	30 e0       	ldi	r19, 0x00	; 0
    10ca:	a0 e0       	ldi	r26, 0x00	; 0
    10cc:	b0 e0       	ldi	r27, 0x00	; 0
    10ce:	30 97       	sbiw	r30, 0x00	; 0
    10d0:	19 f1       	breq	.+70     	; 0x1118 <malloc+0x6c>
    10d2:	40 81       	ld	r20, Z
    10d4:	51 81       	ldd	r21, Z+1	; 0x01
    10d6:	02 81       	ldd	r16, Z+2	; 0x02
    10d8:	13 81       	ldd	r17, Z+3	; 0x03
    10da:	48 17       	cp	r20, r24
    10dc:	59 07       	cpc	r21, r25
    10de:	c8 f0       	brcs	.+50     	; 0x1112 <malloc+0x66>
    10e0:	84 17       	cp	r24, r20
    10e2:	95 07       	cpc	r25, r21
    10e4:	69 f4       	brne	.+26     	; 0x1100 <malloc+0x54>
    10e6:	10 97       	sbiw	r26, 0x00	; 0
    10e8:	31 f0       	breq	.+12     	; 0x10f6 <malloc+0x4a>
    10ea:	12 96       	adiw	r26, 0x02	; 2
    10ec:	0c 93       	st	X, r16
    10ee:	12 97       	sbiw	r26, 0x02	; 2
    10f0:	13 96       	adiw	r26, 0x03	; 3
    10f2:	1c 93       	st	X, r17
    10f4:	27 c0       	rjmp	.+78     	; 0x1144 <malloc+0x98>
    10f6:	00 93 ea 02 	sts	0x02EA, r16	; 0x8002ea <__flp>
    10fa:	10 93 eb 02 	sts	0x02EB, r17	; 0x8002eb <__flp+0x1>
    10fe:	22 c0       	rjmp	.+68     	; 0x1144 <malloc+0x98>
    1100:	21 15       	cp	r18, r1
    1102:	31 05       	cpc	r19, r1
    1104:	19 f0       	breq	.+6      	; 0x110c <malloc+0x60>
    1106:	42 17       	cp	r20, r18
    1108:	53 07       	cpc	r21, r19
    110a:	18 f4       	brcc	.+6      	; 0x1112 <malloc+0x66>
    110c:	9a 01       	movw	r18, r20
    110e:	bd 01       	movw	r22, r26
    1110:	ef 01       	movw	r28, r30
    1112:	df 01       	movw	r26, r30
    1114:	f8 01       	movw	r30, r16
    1116:	db cf       	rjmp	.-74     	; 0x10ce <malloc+0x22>
    1118:	21 15       	cp	r18, r1
    111a:	31 05       	cpc	r19, r1
    111c:	f9 f0       	breq	.+62     	; 0x115c <malloc+0xb0>
    111e:	28 1b       	sub	r18, r24
    1120:	39 0b       	sbc	r19, r25
    1122:	24 30       	cpi	r18, 0x04	; 4
    1124:	31 05       	cpc	r19, r1
    1126:	80 f4       	brcc	.+32     	; 0x1148 <malloc+0x9c>
    1128:	8a 81       	ldd	r24, Y+2	; 0x02
    112a:	9b 81       	ldd	r25, Y+3	; 0x03
    112c:	61 15       	cp	r22, r1
    112e:	71 05       	cpc	r23, r1
    1130:	21 f0       	breq	.+8      	; 0x113a <malloc+0x8e>
    1132:	fb 01       	movw	r30, r22
    1134:	93 83       	std	Z+3, r25	; 0x03
    1136:	82 83       	std	Z+2, r24	; 0x02
    1138:	04 c0       	rjmp	.+8      	; 0x1142 <malloc+0x96>
    113a:	90 93 eb 02 	sts	0x02EB, r25	; 0x8002eb <__flp+0x1>
    113e:	80 93 ea 02 	sts	0x02EA, r24	; 0x8002ea <__flp>
    1142:	fe 01       	movw	r30, r28
    1144:	32 96       	adiw	r30, 0x02	; 2
    1146:	44 c0       	rjmp	.+136    	; 0x11d0 <malloc+0x124>
    1148:	fe 01       	movw	r30, r28
    114a:	e2 0f       	add	r30, r18
    114c:	f3 1f       	adc	r31, r19
    114e:	81 93       	st	Z+, r24
    1150:	91 93       	st	Z+, r25
    1152:	22 50       	subi	r18, 0x02	; 2
    1154:	31 09       	sbc	r19, r1
    1156:	39 83       	std	Y+1, r19	; 0x01
    1158:	28 83       	st	Y, r18
    115a:	3a c0       	rjmp	.+116    	; 0x11d0 <malloc+0x124>
    115c:	20 91 e8 02 	lds	r18, 0x02E8	; 0x8002e8 <__brkval>
    1160:	30 91 e9 02 	lds	r19, 0x02E9	; 0x8002e9 <__brkval+0x1>
    1164:	23 2b       	or	r18, r19
    1166:	41 f4       	brne	.+16     	; 0x1178 <malloc+0xcc>
    1168:	20 91 02 02 	lds	r18, 0x0202	; 0x800202 <__malloc_heap_start>
    116c:	30 91 03 02 	lds	r19, 0x0203	; 0x800203 <__malloc_heap_start+0x1>
    1170:	30 93 e9 02 	sts	0x02E9, r19	; 0x8002e9 <__brkval+0x1>
    1174:	20 93 e8 02 	sts	0x02E8, r18	; 0x8002e8 <__brkval>
    1178:	20 91 00 02 	lds	r18, 0x0200	; 0x800200 <__data_start>
    117c:	30 91 01 02 	lds	r19, 0x0201	; 0x800201 <__data_start+0x1>
    1180:	21 15       	cp	r18, r1
    1182:	31 05       	cpc	r19, r1
    1184:	41 f4       	brne	.+16     	; 0x1196 <malloc+0xea>
    1186:	2d b7       	in	r18, 0x3d	; 61
    1188:	3e b7       	in	r19, 0x3e	; 62
    118a:	40 91 04 02 	lds	r20, 0x0204	; 0x800204 <__malloc_margin>
    118e:	50 91 05 02 	lds	r21, 0x0205	; 0x800205 <__malloc_margin+0x1>
    1192:	24 1b       	sub	r18, r20
    1194:	35 0b       	sbc	r19, r21
    1196:	e0 91 e8 02 	lds	r30, 0x02E8	; 0x8002e8 <__brkval>
    119a:	f0 91 e9 02 	lds	r31, 0x02E9	; 0x8002e9 <__brkval+0x1>
    119e:	e2 17       	cp	r30, r18
    11a0:	f3 07       	cpc	r31, r19
    11a2:	a0 f4       	brcc	.+40     	; 0x11cc <malloc+0x120>
    11a4:	2e 1b       	sub	r18, r30
    11a6:	3f 0b       	sbc	r19, r31
    11a8:	28 17       	cp	r18, r24
    11aa:	39 07       	cpc	r19, r25
    11ac:	78 f0       	brcs	.+30     	; 0x11cc <malloc+0x120>
    11ae:	ac 01       	movw	r20, r24
    11b0:	4e 5f       	subi	r20, 0xFE	; 254
    11b2:	5f 4f       	sbci	r21, 0xFF	; 255
    11b4:	24 17       	cp	r18, r20
    11b6:	35 07       	cpc	r19, r21
    11b8:	48 f0       	brcs	.+18     	; 0x11cc <malloc+0x120>
    11ba:	4e 0f       	add	r20, r30
    11bc:	5f 1f       	adc	r21, r31
    11be:	50 93 e9 02 	sts	0x02E9, r21	; 0x8002e9 <__brkval+0x1>
    11c2:	40 93 e8 02 	sts	0x02E8, r20	; 0x8002e8 <__brkval>
    11c6:	81 93       	st	Z+, r24
    11c8:	91 93       	st	Z+, r25
    11ca:	02 c0       	rjmp	.+4      	; 0x11d0 <malloc+0x124>
    11cc:	e0 e0       	ldi	r30, 0x00	; 0
    11ce:	f0 e0       	ldi	r31, 0x00	; 0
    11d0:	cf 01       	movw	r24, r30
    11d2:	df 91       	pop	r29
    11d4:	cf 91       	pop	r28
    11d6:	1f 91       	pop	r17
    11d8:	0f 91       	pop	r16
    11da:	08 95       	ret

000011dc <free>:
    11dc:	cf 93       	push	r28
    11de:	df 93       	push	r29
    11e0:	00 97       	sbiw	r24, 0x00	; 0
    11e2:	09 f4       	brne	.+2      	; 0x11e6 <free+0xa>
    11e4:	81 c0       	rjmp	.+258    	; 0x12e8 <free+0x10c>
    11e6:	fc 01       	movw	r30, r24
    11e8:	32 97       	sbiw	r30, 0x02	; 2
    11ea:	13 82       	std	Z+3, r1	; 0x03
    11ec:	12 82       	std	Z+2, r1	; 0x02
    11ee:	a0 91 ea 02 	lds	r26, 0x02EA	; 0x8002ea <__flp>
    11f2:	b0 91 eb 02 	lds	r27, 0x02EB	; 0x8002eb <__flp+0x1>
    11f6:	10 97       	sbiw	r26, 0x00	; 0
    11f8:	81 f4       	brne	.+32     	; 0x121a <free+0x3e>
    11fa:	20 81       	ld	r18, Z
    11fc:	31 81       	ldd	r19, Z+1	; 0x01
    11fe:	82 0f       	add	r24, r18
    1200:	93 1f       	adc	r25, r19
    1202:	20 91 e8 02 	lds	r18, 0x02E8	; 0x8002e8 <__brkval>
    1206:	30 91 e9 02 	lds	r19, 0x02E9	; 0x8002e9 <__brkval+0x1>
    120a:	28 17       	cp	r18, r24
    120c:	39 07       	cpc	r19, r25
    120e:	51 f5       	brne	.+84     	; 0x1264 <free+0x88>
    1210:	f0 93 e9 02 	sts	0x02E9, r31	; 0x8002e9 <__brkval+0x1>
    1214:	e0 93 e8 02 	sts	0x02E8, r30	; 0x8002e8 <__brkval>
    1218:	67 c0       	rjmp	.+206    	; 0x12e8 <free+0x10c>
    121a:	ed 01       	movw	r28, r26
    121c:	20 e0       	ldi	r18, 0x00	; 0
    121e:	30 e0       	ldi	r19, 0x00	; 0
    1220:	ce 17       	cp	r28, r30
    1222:	df 07       	cpc	r29, r31
    1224:	40 f4       	brcc	.+16     	; 0x1236 <free+0x5a>
    1226:	4a 81       	ldd	r20, Y+2	; 0x02
    1228:	5b 81       	ldd	r21, Y+3	; 0x03
    122a:	9e 01       	movw	r18, r28
    122c:	41 15       	cp	r20, r1
    122e:	51 05       	cpc	r21, r1
    1230:	f1 f0       	breq	.+60     	; 0x126e <free+0x92>
    1232:	ea 01       	movw	r28, r20
    1234:	f5 cf       	rjmp	.-22     	; 0x1220 <free+0x44>
    1236:	d3 83       	std	Z+3, r29	; 0x03
    1238:	c2 83       	std	Z+2, r28	; 0x02
    123a:	40 81       	ld	r20, Z
    123c:	51 81       	ldd	r21, Z+1	; 0x01
    123e:	84 0f       	add	r24, r20
    1240:	95 1f       	adc	r25, r21
    1242:	c8 17       	cp	r28, r24
    1244:	d9 07       	cpc	r29, r25
    1246:	59 f4       	brne	.+22     	; 0x125e <free+0x82>
    1248:	88 81       	ld	r24, Y
    124a:	99 81       	ldd	r25, Y+1	; 0x01
    124c:	84 0f       	add	r24, r20
    124e:	95 1f       	adc	r25, r21
    1250:	02 96       	adiw	r24, 0x02	; 2
    1252:	91 83       	std	Z+1, r25	; 0x01
    1254:	80 83       	st	Z, r24
    1256:	8a 81       	ldd	r24, Y+2	; 0x02
    1258:	9b 81       	ldd	r25, Y+3	; 0x03
    125a:	93 83       	std	Z+3, r25	; 0x03
    125c:	82 83       	std	Z+2, r24	; 0x02
    125e:	21 15       	cp	r18, r1
    1260:	31 05       	cpc	r19, r1
    1262:	29 f4       	brne	.+10     	; 0x126e <free+0x92>
    1264:	f0 93 eb 02 	sts	0x02EB, r31	; 0x8002eb <__flp+0x1>
    1268:	e0 93 ea 02 	sts	0x02EA, r30	; 0x8002ea <__flp>
    126c:	3d c0       	rjmp	.+122    	; 0x12e8 <free+0x10c>
    126e:	e9 01       	movw	r28, r18
    1270:	fb 83       	std	Y+3, r31	; 0x03
    1272:	ea 83       	std	Y+2, r30	; 0x02
    1274:	49 91       	ld	r20, Y+
    1276:	59 91       	ld	r21, Y+
    1278:	c4 0f       	add	r28, r20
    127a:	d5 1f       	adc	r29, r21
    127c:	ec 17       	cp	r30, r28
    127e:	fd 07       	cpc	r31, r29
    1280:	61 f4       	brne	.+24     	; 0x129a <free+0xbe>
    1282:	80 81       	ld	r24, Z
    1284:	91 81       	ldd	r25, Z+1	; 0x01
    1286:	84 0f       	add	r24, r20
    1288:	95 1f       	adc	r25, r21
    128a:	02 96       	adiw	r24, 0x02	; 2
    128c:	e9 01       	movw	r28, r18
    128e:	99 83       	std	Y+1, r25	; 0x01
    1290:	88 83       	st	Y, r24
    1292:	82 81       	ldd	r24, Z+2	; 0x02
    1294:	93 81       	ldd	r25, Z+3	; 0x03
    1296:	9b 83       	std	Y+3, r25	; 0x03
    1298:	8a 83       	std	Y+2, r24	; 0x02
    129a:	e0 e0       	ldi	r30, 0x00	; 0
    129c:	f0 e0       	ldi	r31, 0x00	; 0
    129e:	12 96       	adiw	r26, 0x02	; 2
    12a0:	8d 91       	ld	r24, X+
    12a2:	9c 91       	ld	r25, X
    12a4:	13 97       	sbiw	r26, 0x03	; 3
    12a6:	00 97       	sbiw	r24, 0x00	; 0
    12a8:	19 f0       	breq	.+6      	; 0x12b0 <free+0xd4>
    12aa:	fd 01       	movw	r30, r26
    12ac:	dc 01       	movw	r26, r24
    12ae:	f7 cf       	rjmp	.-18     	; 0x129e <free+0xc2>
    12b0:	8d 91       	ld	r24, X+
    12b2:	9c 91       	ld	r25, X
    12b4:	11 97       	sbiw	r26, 0x01	; 1
    12b6:	9d 01       	movw	r18, r26
    12b8:	2e 5f       	subi	r18, 0xFE	; 254
    12ba:	3f 4f       	sbci	r19, 0xFF	; 255
    12bc:	82 0f       	add	r24, r18
    12be:	93 1f       	adc	r25, r19
    12c0:	20 91 e8 02 	lds	r18, 0x02E8	; 0x8002e8 <__brkval>
    12c4:	30 91 e9 02 	lds	r19, 0x02E9	; 0x8002e9 <__brkval+0x1>
    12c8:	28 17       	cp	r18, r24
    12ca:	39 07       	cpc	r19, r25
    12cc:	69 f4       	brne	.+26     	; 0x12e8 <free+0x10c>
    12ce:	30 97       	sbiw	r30, 0x00	; 0
    12d0:	29 f4       	brne	.+10     	; 0x12dc <free+0x100>
    12d2:	10 92 eb 02 	sts	0x02EB, r1	; 0x8002eb <__flp+0x1>
    12d6:	10 92 ea 02 	sts	0x02EA, r1	; 0x8002ea <__flp>
    12da:	02 c0       	rjmp	.+4      	; 0x12e0 <free+0x104>
    12dc:	13 82       	std	Z+3, r1	; 0x03
    12de:	12 82       	std	Z+2, r1	; 0x02
    12e0:	b0 93 e9 02 	sts	0x02E9, r27	; 0x8002e9 <__brkval+0x1>
    12e4:	a0 93 e8 02 	sts	0x02E8, r26	; 0x8002e8 <__brkval>
    12e8:	df 91       	pop	r29
    12ea:	cf 91       	pop	r28
    12ec:	08 95       	ret

000012ee <realloc>:
    12ee:	6f 92       	push	r6
    12f0:	7f 92       	push	r7
    12f2:	8f 92       	push	r8
    12f4:	9f 92       	push	r9
    12f6:	af 92       	push	r10
    12f8:	bf 92       	push	r11
    12fa:	cf 92       	push	r12
    12fc:	df 92       	push	r13
    12fe:	ef 92       	push	r14
    1300:	ff 92       	push	r15
    1302:	0f 93       	push	r16
    1304:	1f 93       	push	r17
    1306:	cf 93       	push	r28
    1308:	df 93       	push	r29
    130a:	00 97       	sbiw	r24, 0x00	; 0
    130c:	81 f4       	brne	.+32     	; 0x132e <realloc+0x40>
    130e:	cb 01       	movw	r24, r22
    1310:	df 91       	pop	r29
    1312:	cf 91       	pop	r28
    1314:	1f 91       	pop	r17
    1316:	0f 91       	pop	r16
    1318:	ff 90       	pop	r15
    131a:	ef 90       	pop	r14
    131c:	df 90       	pop	r13
    131e:	cf 90       	pop	r12
    1320:	bf 90       	pop	r11
    1322:	af 90       	pop	r10
    1324:	9f 90       	pop	r9
    1326:	8f 90       	pop	r8
    1328:	7f 90       	pop	r7
    132a:	6f 90       	pop	r6
    132c:	bf ce       	rjmp	.-642    	; 0x10ac <malloc>
    132e:	fc 01       	movw	r30, r24
    1330:	e6 0f       	add	r30, r22
    1332:	f7 1f       	adc	r31, r23
    1334:	9c 01       	movw	r18, r24
    1336:	22 50       	subi	r18, 0x02	; 2
    1338:	31 09       	sbc	r19, r1
    133a:	e2 17       	cp	r30, r18
    133c:	f3 07       	cpc	r31, r19
    133e:	08 f4       	brcc	.+2      	; 0x1342 <realloc+0x54>
    1340:	a5 c0       	rjmp	.+330    	; 0x148c <realloc+0x19e>
    1342:	ec 01       	movw	r28, r24
    1344:	d9 01       	movw	r26, r18
    1346:	0d 91       	ld	r16, X+
    1348:	1c 91       	ld	r17, X
    134a:	11 97       	sbiw	r26, 0x01	; 1
    134c:	06 17       	cp	r16, r22
    134e:	17 07       	cpc	r17, r23
    1350:	a8 f0       	brcs	.+42     	; 0x137c <realloc+0x8e>
    1352:	05 30       	cpi	r16, 0x05	; 5
    1354:	11 05       	cpc	r17, r1
    1356:	08 f4       	brcc	.+2      	; 0x135a <realloc+0x6c>
    1358:	97 c0       	rjmp	.+302    	; 0x1488 <realloc+0x19a>
    135a:	c8 01       	movw	r24, r16
    135c:	04 97       	sbiw	r24, 0x04	; 4
    135e:	86 17       	cp	r24, r22
    1360:	97 07       	cpc	r25, r23
    1362:	08 f4       	brcc	.+2      	; 0x1366 <realloc+0x78>
    1364:	91 c0       	rjmp	.+290    	; 0x1488 <realloc+0x19a>
    1366:	02 50       	subi	r16, 0x02	; 2
    1368:	11 09       	sbc	r17, r1
    136a:	06 1b       	sub	r16, r22
    136c:	17 0b       	sbc	r17, r23
    136e:	01 93       	st	Z+, r16
    1370:	11 93       	st	Z+, r17
    1372:	6d 93       	st	X+, r22
    1374:	7c 93       	st	X, r23
    1376:	cf 01       	movw	r24, r30
    1378:	31 df       	rcall	.-414    	; 0x11dc <free>
    137a:	86 c0       	rjmp	.+268    	; 0x1488 <realloc+0x19a>
    137c:	5b 01       	movw	r10, r22
    137e:	a0 1a       	sub	r10, r16
    1380:	b1 0a       	sbc	r11, r17
    1382:	4c 01       	movw	r8, r24
    1384:	80 0e       	add	r8, r16
    1386:	91 1e       	adc	r9, r17
    1388:	a0 91 ea 02 	lds	r26, 0x02EA	; 0x8002ea <__flp>
    138c:	b0 91 eb 02 	lds	r27, 0x02EB	; 0x8002eb <__flp+0x1>
    1390:	61 2c       	mov	r6, r1
    1392:	71 2c       	mov	r7, r1
    1394:	e1 2c       	mov	r14, r1
    1396:	f1 2c       	mov	r15, r1
    1398:	10 97       	sbiw	r26, 0x00	; 0
    139a:	09 f4       	brne	.+2      	; 0x139e <realloc+0xb0>
    139c:	46 c0       	rjmp	.+140    	; 0x142a <realloc+0x13c>
    139e:	8d 91       	ld	r24, X+
    13a0:	9c 91       	ld	r25, X
    13a2:	11 97       	sbiw	r26, 0x01	; 1
    13a4:	a8 15       	cp	r26, r8
    13a6:	b9 05       	cpc	r27, r9
    13a8:	b1 f5       	brne	.+108    	; 0x1416 <realloc+0x128>
    13aa:	6c 01       	movw	r12, r24
    13ac:	42 e0       	ldi	r20, 0x02	; 2
    13ae:	c4 0e       	add	r12, r20
    13b0:	d1 1c       	adc	r13, r1
    13b2:	ca 14       	cp	r12, r10
    13b4:	db 04       	cpc	r13, r11
    13b6:	78 f1       	brcs	.+94     	; 0x1416 <realloc+0x128>
    13b8:	4c 01       	movw	r8, r24
    13ba:	8a 18       	sub	r8, r10
    13bc:	9b 08       	sbc	r9, r11
    13be:	64 01       	movw	r12, r8
    13c0:	42 e0       	ldi	r20, 0x02	; 2
    13c2:	c4 0e       	add	r12, r20
    13c4:	d1 1c       	adc	r13, r1
    13c6:	12 96       	adiw	r26, 0x02	; 2
    13c8:	bc 90       	ld	r11, X
    13ca:	12 97       	sbiw	r26, 0x02	; 2
    13cc:	13 96       	adiw	r26, 0x03	; 3
    13ce:	ac 91       	ld	r26, X
    13d0:	b5 e0       	ldi	r27, 0x05	; 5
    13d2:	cb 16       	cp	r12, r27
    13d4:	d1 04       	cpc	r13, r1
    13d6:	40 f0       	brcs	.+16     	; 0x13e8 <realloc+0xfa>
    13d8:	b2 82       	std	Z+2, r11	; 0x02
    13da:	a3 83       	std	Z+3, r26	; 0x03
    13dc:	91 82       	std	Z+1, r9	; 0x01
    13de:	80 82       	st	Z, r8
    13e0:	d9 01       	movw	r26, r18
    13e2:	6d 93       	st	X+, r22
    13e4:	7c 93       	st	X, r23
    13e6:	09 c0       	rjmp	.+18     	; 0x13fa <realloc+0x10c>
    13e8:	0e 5f       	subi	r16, 0xFE	; 254
    13ea:	1f 4f       	sbci	r17, 0xFF	; 255
    13ec:	80 0f       	add	r24, r16
    13ee:	91 1f       	adc	r25, r17
    13f0:	f9 01       	movw	r30, r18
    13f2:	91 83       	std	Z+1, r25	; 0x01
    13f4:	80 83       	st	Z, r24
    13f6:	eb 2d       	mov	r30, r11
    13f8:	fa 2f       	mov	r31, r26
    13fa:	e1 14       	cp	r14, r1
    13fc:	f1 04       	cpc	r15, r1
    13fe:	31 f0       	breq	.+12     	; 0x140c <realloc+0x11e>
    1400:	d7 01       	movw	r26, r14
    1402:	13 96       	adiw	r26, 0x03	; 3
    1404:	fc 93       	st	X, r31
    1406:	ee 93       	st	-X, r30
    1408:	12 97       	sbiw	r26, 0x02	; 2
    140a:	3e c0       	rjmp	.+124    	; 0x1488 <realloc+0x19a>
    140c:	f0 93 eb 02 	sts	0x02EB, r31	; 0x8002eb <__flp+0x1>
    1410:	e0 93 ea 02 	sts	0x02EA, r30	; 0x8002ea <__flp>
    1414:	39 c0       	rjmp	.+114    	; 0x1488 <realloc+0x19a>
    1416:	68 16       	cp	r6, r24
    1418:	79 06       	cpc	r7, r25
    141a:	08 f4       	brcc	.+2      	; 0x141e <realloc+0x130>
    141c:	3c 01       	movw	r6, r24
    141e:	7d 01       	movw	r14, r26
    1420:	12 96       	adiw	r26, 0x02	; 2
    1422:	0d 90       	ld	r0, X+
    1424:	bc 91       	ld	r27, X
    1426:	a0 2d       	mov	r26, r0
    1428:	b7 cf       	rjmp	.-146    	; 0x1398 <realloc+0xaa>
    142a:	80 91 e8 02 	lds	r24, 0x02E8	; 0x8002e8 <__brkval>
    142e:	90 91 e9 02 	lds	r25, 0x02E9	; 0x8002e9 <__brkval+0x1>
    1432:	88 16       	cp	r8, r24
    1434:	99 06       	cpc	r9, r25
    1436:	e1 f4       	brne	.+56     	; 0x1470 <realloc+0x182>
    1438:	66 16       	cp	r6, r22
    143a:	77 06       	cpc	r7, r23
    143c:	c8 f4       	brcc	.+50     	; 0x1470 <realloc+0x182>
    143e:	80 91 00 02 	lds	r24, 0x0200	; 0x800200 <__data_start>
    1442:	90 91 01 02 	lds	r25, 0x0201	; 0x800201 <__data_start+0x1>
    1446:	00 97       	sbiw	r24, 0x00	; 0
    1448:	41 f4       	brne	.+16     	; 0x145a <realloc+0x16c>
    144a:	8d b7       	in	r24, 0x3d	; 61
    144c:	9e b7       	in	r25, 0x3e	; 62
    144e:	40 91 04 02 	lds	r20, 0x0204	; 0x800204 <__malloc_margin>
    1452:	50 91 05 02 	lds	r21, 0x0205	; 0x800205 <__malloc_margin+0x1>
    1456:	84 1b       	sub	r24, r20
    1458:	95 0b       	sbc	r25, r21
    145a:	e8 17       	cp	r30, r24
    145c:	f9 07       	cpc	r31, r25
    145e:	b0 f4       	brcc	.+44     	; 0x148c <realloc+0x19e>
    1460:	f0 93 e9 02 	sts	0x02E9, r31	; 0x8002e9 <__brkval+0x1>
    1464:	e0 93 e8 02 	sts	0x02E8, r30	; 0x8002e8 <__brkval>
    1468:	f9 01       	movw	r30, r18
    146a:	71 83       	std	Z+1, r23	; 0x01
    146c:	60 83       	st	Z, r22
    146e:	0c c0       	rjmp	.+24     	; 0x1488 <realloc+0x19a>
    1470:	cb 01       	movw	r24, r22
    1472:	1c de       	rcall	.-968    	; 0x10ac <malloc>
    1474:	7c 01       	movw	r14, r24
    1476:	00 97       	sbiw	r24, 0x00	; 0
    1478:	49 f0       	breq	.+18     	; 0x148c <realloc+0x19e>
    147a:	a8 01       	movw	r20, r16
    147c:	be 01       	movw	r22, r28
    147e:	1b d0       	rcall	.+54     	; 0x14b6 <memcpy>
    1480:	ce 01       	movw	r24, r28
    1482:	ac de       	rcall	.-680    	; 0x11dc <free>
    1484:	c7 01       	movw	r24, r14
    1486:	04 c0       	rjmp	.+8      	; 0x1490 <realloc+0x1a2>
    1488:	ce 01       	movw	r24, r28
    148a:	02 c0       	rjmp	.+4      	; 0x1490 <realloc+0x1a2>
    148c:	80 e0       	ldi	r24, 0x00	; 0
    148e:	90 e0       	ldi	r25, 0x00	; 0
    1490:	df 91       	pop	r29
    1492:	cf 91       	pop	r28
    1494:	1f 91       	pop	r17
    1496:	0f 91       	pop	r16
    1498:	ff 90       	pop	r15
    149a:	ef 90       	pop	r14
    149c:	df 90       	pop	r13
    149e:	cf 90       	pop	r12
    14a0:	bf 90       	pop	r11
    14a2:	af 90       	pop	r10
    14a4:	9f 90       	pop	r9
    14a6:	8f 90       	pop	r8
    14a8:	7f 90       	pop	r7
    14aa:	6f 90       	pop	r6
    14ac:	08 95       	ret

000014ae <abort>:
    14ae:	81 e0       	ldi	r24, 0x01	; 1
    14b0:	90 e0       	ldi	r25, 0x00	; 0
    14b2:	f8 94       	cli
    14b4:	10 c0       	rjmp	.+32     	; 0x14d6 <_exit>

000014b6 <memcpy>:
    14b6:	fb 01       	movw	r30, r22
    14b8:	dc 01       	movw	r26, r24
    14ba:	02 c0       	rjmp	.+4      	; 0x14c0 <memcpy+0xa>
    14bc:	01 90       	ld	r0, Z+
    14be:	0d 92       	st	X+, r0
    14c0:	41 50       	subi	r20, 0x01	; 1
    14c2:	50 40       	sbci	r21, 0x00	; 0
    14c4:	d8 f7       	brcc	.-10     	; 0x14bc <memcpy+0x6>
    14c6:	08 95       	ret

000014c8 <strcpy>:
    14c8:	fb 01       	movw	r30, r22
    14ca:	dc 01       	movw	r26, r24
    14cc:	01 90       	ld	r0, Z+
    14ce:	0d 92       	st	X+, r0
    14d0:	00 20       	and	r0, r0
    14d2:	e1 f7       	brne	.-8      	; 0x14cc <strcpy+0x4>
    14d4:	08 95       	ret

000014d6 <_exit>:
    14d6:	f8 94       	cli

000014d8 <__stop_program>:
    14d8:	ff cf       	rjmp	.-2      	; 0x14d8 <__stop_program>
